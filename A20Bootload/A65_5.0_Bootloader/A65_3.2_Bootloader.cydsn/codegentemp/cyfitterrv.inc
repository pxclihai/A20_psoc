    IF :LNOT::DEF:INCLUDED_CYFITTERRV_INC
INCLUDED_CYFITTERRV_INC EQU 1
    GET cydevicerv.inc
    GET cydevicerv_trm.inc

; CS
CS__0__INTTYPE EQU CYREG_PICU12_INTTYPE2
CS__0__MASK EQU 0x04
CS__0__PC EQU CYREG_PRT12_PC2
CS__0__PORT EQU 12
CS__0__SHIFT EQU 2
CS__AG EQU CYREG_PRT12_AG
CS__BIE EQU CYREG_PRT12_BIE
CS__BIT_MASK EQU CYREG_PRT12_BIT_MASK
CS__BYP EQU CYREG_PRT12_BYP
CS__DM0 EQU CYREG_PRT12_DM0
CS__DM1 EQU CYREG_PRT12_DM1
CS__DM2 EQU CYREG_PRT12_DM2
CS__DR EQU CYREG_PRT12_DR
CS__INP_DIS EQU CYREG_PRT12_INP_DIS
CS__INTTYPE_BASE EQU CYDEV_PICU_INTTYPE_PICU12_BASE
CS__MASK EQU 0x04
CS__PORT EQU 12
CS__PRT EQU CYREG_PRT12_PRT
CS__PRTDSI__DBL_SYNC_IN EQU CYREG_PRT12_DBL_SYNC_IN
CS__PRTDSI__OE_SEL0 EQU CYREG_PRT12_OE_SEL0
CS__PRTDSI__OE_SEL1 EQU CYREG_PRT12_OE_SEL1
CS__PRTDSI__OUT_SEL0 EQU CYREG_PRT12_OUT_SEL0
CS__PRTDSI__OUT_SEL1 EQU CYREG_PRT12_OUT_SEL1
CS__PRTDSI__SYNC_OUT EQU CYREG_PRT12_SYNC_OUT
CS__PS EQU CYREG_PRT12_PS
CS__SHIFT EQU 2
CS__SIO_CFG EQU CYREG_PRT12_SIO_CFG
CS__SIO_DIFF EQU CYREG_PRT12_SIO_DIFF
CS__SIO_HYST_EN EQU CYREG_PRT12_SIO_HYST_EN
CS__SIO_REG_HIFREQ EQU CYREG_PRT12_SIO_REG_HIFREQ
CS__SLW EQU CYREG_PRT12_SLW

; RD
RD__0__INTTYPE EQU CYREG_PICU12_INTTYPE3
RD__0__MASK EQU 0x08
RD__0__PC EQU CYREG_PRT12_PC3
RD__0__PORT EQU 12
RD__0__SHIFT EQU 3
RD__AG EQU CYREG_PRT12_AG
RD__BIE EQU CYREG_PRT12_BIE
RD__BIT_MASK EQU CYREG_PRT12_BIT_MASK
RD__BYP EQU CYREG_PRT12_BYP
RD__DM0 EQU CYREG_PRT12_DM0
RD__DM1 EQU CYREG_PRT12_DM1
RD__DM2 EQU CYREG_PRT12_DM2
RD__DR EQU CYREG_PRT12_DR
RD__INP_DIS EQU CYREG_PRT12_INP_DIS
RD__INTTYPE_BASE EQU CYDEV_PICU_INTTYPE_PICU12_BASE
RD__MASK EQU 0x08
RD__PORT EQU 12
RD__PRT EQU CYREG_PRT12_PRT
RD__PRTDSI__DBL_SYNC_IN EQU CYREG_PRT12_DBL_SYNC_IN
RD__PRTDSI__OE_SEL0 EQU CYREG_PRT12_OE_SEL0
RD__PRTDSI__OE_SEL1 EQU CYREG_PRT12_OE_SEL1
RD__PRTDSI__OUT_SEL0 EQU CYREG_PRT12_OUT_SEL0
RD__PRTDSI__OUT_SEL1 EQU CYREG_PRT12_OUT_SEL1
RD__PRTDSI__SYNC_OUT EQU CYREG_PRT12_SYNC_OUT
RD__PS EQU CYREG_PRT12_PS
RD__SHIFT EQU 3
RD__SIO_CFG EQU CYREG_PRT12_SIO_CFG
RD__SIO_DIFF EQU CYREG_PRT12_SIO_DIFF
RD__SIO_HYST_EN EQU CYREG_PRT12_SIO_HYST_EN
RD__SIO_REG_HIFREQ EQU CYREG_PRT12_SIO_REG_HIFREQ
RD__SLW EQU CYREG_PRT12_SLW

; RS
RS__0__INTTYPE EQU CYREG_PICU4_INTTYPE1
RS__0__MASK EQU 0x02
RS__0__PC EQU CYREG_PRT4_PC1
RS__0__PORT EQU 4
RS__0__SHIFT EQU 1
RS__AG EQU CYREG_PRT4_AG
RS__AMUX EQU CYREG_PRT4_AMUX
RS__BIE EQU CYREG_PRT4_BIE
RS__BIT_MASK EQU CYREG_PRT4_BIT_MASK
RS__BYP EQU CYREG_PRT4_BYP
RS__CTL EQU CYREG_PRT4_CTL
RS__DM0 EQU CYREG_PRT4_DM0
RS__DM1 EQU CYREG_PRT4_DM1
RS__DM2 EQU CYREG_PRT4_DM2
RS__DR EQU CYREG_PRT4_DR
RS__INP_DIS EQU CYREG_PRT4_INP_DIS
RS__INTTYPE_BASE EQU CYDEV_PICU_INTTYPE_PICU4_BASE
RS__LCD_COM_SEG EQU CYREG_PRT4_LCD_COM_SEG
RS__LCD_EN EQU CYREG_PRT4_LCD_EN
RS__MASK EQU 0x02
RS__PORT EQU 4
RS__PRT EQU CYREG_PRT4_PRT
RS__PRTDSI__CAPS_SEL EQU CYREG_PRT4_CAPS_SEL
RS__PRTDSI__DBL_SYNC_IN EQU CYREG_PRT4_DBL_SYNC_IN
RS__PRTDSI__OE_SEL0 EQU CYREG_PRT4_OE_SEL0
RS__PRTDSI__OE_SEL1 EQU CYREG_PRT4_OE_SEL1
RS__PRTDSI__OUT_SEL0 EQU CYREG_PRT4_OUT_SEL0
RS__PRTDSI__OUT_SEL1 EQU CYREG_PRT4_OUT_SEL1
RS__PRTDSI__SYNC_OUT EQU CYREG_PRT4_SYNC_OUT
RS__PS EQU CYREG_PRT4_PS
RS__SHIFT EQU 1
RS__SLW EQU CYREG_PRT4_SLW

; WR
WR__0__INTTYPE EQU CYREG_PICU4_INTTYPE0
WR__0__MASK EQU 0x01
WR__0__PC EQU CYREG_PRT4_PC0
WR__0__PORT EQU 4
WR__0__SHIFT EQU 0
WR__AG EQU CYREG_PRT4_AG
WR__AMUX EQU CYREG_PRT4_AMUX
WR__BIE EQU CYREG_PRT4_BIE
WR__BIT_MASK EQU CYREG_PRT4_BIT_MASK
WR__BYP EQU CYREG_PRT4_BYP
WR__CTL EQU CYREG_PRT4_CTL
WR__DM0 EQU CYREG_PRT4_DM0
WR__DM1 EQU CYREG_PRT4_DM1
WR__DM2 EQU CYREG_PRT4_DM2
WR__DR EQU CYREG_PRT4_DR
WR__INP_DIS EQU CYREG_PRT4_INP_DIS
WR__INTTYPE_BASE EQU CYDEV_PICU_INTTYPE_PICU4_BASE
WR__LCD_COM_SEG EQU CYREG_PRT4_LCD_COM_SEG
WR__LCD_EN EQU CYREG_PRT4_LCD_EN
WR__MASK EQU 0x01
WR__PORT EQU 4
WR__PRT EQU CYREG_PRT4_PRT
WR__PRTDSI__CAPS_SEL EQU CYREG_PRT4_CAPS_SEL
WR__PRTDSI__DBL_SYNC_IN EQU CYREG_PRT4_DBL_SYNC_IN
WR__PRTDSI__OE_SEL0 EQU CYREG_PRT4_OE_SEL0
WR__PRTDSI__OE_SEL1 EQU CYREG_PRT4_OE_SEL1
WR__PRTDSI__OUT_SEL0 EQU CYREG_PRT4_OUT_SEL0
WR__PRTDSI__OUT_SEL1 EQU CYREG_PRT4_OUT_SEL1
WR__PRTDSI__SYNC_OUT EQU CYREG_PRT4_SYNC_OUT
WR__PS EQU CYREG_PRT4_PS
WR__SHIFT EQU 0
WR__SLW EQU CYREG_PRT4_SLW

; RST
RST__0__INTTYPE EQU CYREG_PICU15_INTTYPE3
RST__0__MASK EQU 0x08
RST__0__PC EQU CYREG_IO_PC_PRT15_PC3
RST__0__PORT EQU 15
RST__0__SHIFT EQU 3
RST__AG EQU CYREG_PRT15_AG
RST__AMUX EQU CYREG_PRT15_AMUX
RST__BIE EQU CYREG_PRT15_BIE
RST__BIT_MASK EQU CYREG_PRT15_BIT_MASK
RST__BYP EQU CYREG_PRT15_BYP
RST__CTL EQU CYREG_PRT15_CTL
RST__DM0 EQU CYREG_PRT15_DM0
RST__DM1 EQU CYREG_PRT15_DM1
RST__DM2 EQU CYREG_PRT15_DM2
RST__DR EQU CYREG_PRT15_DR
RST__INP_DIS EQU CYREG_PRT15_INP_DIS
RST__INTTYPE_BASE EQU CYDEV_PICU_INTTYPE_PICU15_BASE
RST__LCD_COM_SEG EQU CYREG_PRT15_LCD_COM_SEG
RST__LCD_EN EQU CYREG_PRT15_LCD_EN
RST__MASK EQU 0x08
RST__PORT EQU 15
RST__PRT EQU CYREG_PRT15_PRT
RST__PRTDSI__CAPS_SEL EQU CYREG_PRT15_CAPS_SEL
RST__PRTDSI__DBL_SYNC_IN EQU CYREG_PRT15_DBL_SYNC_IN
RST__PRTDSI__OE_SEL0 EQU CYREG_PRT15_OE_SEL0
RST__PRTDSI__OE_SEL1 EQU CYREG_PRT15_OE_SEL1
RST__PRTDSI__OUT_SEL0 EQU CYREG_PRT15_OUT_SEL0
RST__PRTDSI__OUT_SEL1 EQU CYREG_PRT15_OUT_SEL1
RST__PRTDSI__SYNC_OUT EQU CYREG_PRT15_SYNC_OUT
RST__PS EQU CYREG_PRT15_PS
RST__SHIFT EQU 3
RST__SLW EQU CYREG_PRT15_SLW

; DATA
DATA__0__INTTYPE EQU CYREG_PICU0_INTTYPE0
DATA__0__MASK EQU 0x01
DATA__0__PC EQU CYREG_PRT0_PC0
DATA__0__PORT EQU 0
DATA__0__SHIFT EQU 0
DATA__1__INTTYPE EQU CYREG_PICU0_INTTYPE1
DATA__1__MASK EQU 0x02
DATA__1__PC EQU CYREG_PRT0_PC1
DATA__1__PORT EQU 0
DATA__1__SHIFT EQU 1
DATA__2__INTTYPE EQU CYREG_PICU0_INTTYPE2
DATA__2__MASK EQU 0x04
DATA__2__PC EQU CYREG_PRT0_PC2
DATA__2__PORT EQU 0
DATA__2__SHIFT EQU 2
DATA__3__INTTYPE EQU CYREG_PICU0_INTTYPE3
DATA__3__MASK EQU 0x08
DATA__3__PC EQU CYREG_PRT0_PC3
DATA__3__PORT EQU 0
DATA__3__SHIFT EQU 3
DATA__4__INTTYPE EQU CYREG_PICU0_INTTYPE4
DATA__4__MASK EQU 0x10
DATA__4__PC EQU CYREG_PRT0_PC4
DATA__4__PORT EQU 0
DATA__4__SHIFT EQU 4
DATA__5__INTTYPE EQU CYREG_PICU0_INTTYPE5
DATA__5__MASK EQU 0x20
DATA__5__PC EQU CYREG_PRT0_PC5
DATA__5__PORT EQU 0
DATA__5__SHIFT EQU 5
DATA__6__INTTYPE EQU CYREG_PICU0_INTTYPE6
DATA__6__MASK EQU 0x40
DATA__6__PC EQU CYREG_PRT0_PC6
DATA__6__PORT EQU 0
DATA__6__SHIFT EQU 6
DATA__7__INTTYPE EQU CYREG_PICU0_INTTYPE7
DATA__7__MASK EQU 0x80
DATA__7__PC EQU CYREG_PRT0_PC7
DATA__7__PORT EQU 0
DATA__7__SHIFT EQU 7
DATA__AG EQU CYREG_PRT0_AG
DATA__AMUX EQU CYREG_PRT0_AMUX
DATA__BIE EQU CYREG_PRT0_BIE
DATA__BIT_MASK EQU CYREG_PRT0_BIT_MASK
DATA__BYP EQU CYREG_PRT0_BYP
DATA__CTL EQU CYREG_PRT0_CTL
DATA__DM0 EQU CYREG_PRT0_DM0
DATA__DM1 EQU CYREG_PRT0_DM1
DATA__DM2 EQU CYREG_PRT0_DM2
DATA__DR EQU CYREG_PRT0_DR
DATA__INP_DIS EQU CYREG_PRT0_INP_DIS
DATA__INTTYPE_BASE EQU CYDEV_PICU_INTTYPE_PICU0_BASE
DATA__LCD_COM_SEG EQU CYREG_PRT0_LCD_COM_SEG
DATA__LCD_EN EQU CYREG_PRT0_LCD_EN
DATA__MASK EQU 0xFF
DATA__PORT EQU 0
DATA__PRT EQU CYREG_PRT0_PRT
DATA__PRTDSI__CAPS_SEL EQU CYREG_PRT0_CAPS_SEL
DATA__PRTDSI__DBL_SYNC_IN EQU CYREG_PRT0_DBL_SYNC_IN
DATA__PRTDSI__OE_SEL0 EQU CYREG_PRT0_OE_SEL0
DATA__PRTDSI__OE_SEL1 EQU CYREG_PRT0_OE_SEL1
DATA__PRTDSI__OUT_SEL0 EQU CYREG_PRT0_OUT_SEL0
DATA__PRTDSI__OUT_SEL1 EQU CYREG_PRT0_OUT_SEL1
DATA__PRTDSI__SYNC_OUT EQU CYREG_PRT0_SYNC_OUT
DATA__PS EQU CYREG_PRT0_PS
DATA__SHIFT EQU 0
DATA__SLW EQU CYREG_PRT0_SLW

; Clock_1
Clock_1__CFG0 EQU CYREG_CLKDIST_DCFG0_CFG0
Clock_1__CFG1 EQU CYREG_CLKDIST_DCFG0_CFG1
Clock_1__CFG2 EQU CYREG_CLKDIST_DCFG0_CFG2
Clock_1__CFG2_SRC_SEL_MASK EQU 0x07
Clock_1__INDEX EQU 0x00
Clock_1__PM_ACT_CFG EQU CYREG_PM_ACT_CFG2
Clock_1__PM_ACT_MSK EQU 0x01
Clock_1__PM_STBY_CFG EQU CYREG_PM_STBY_CFG2
Clock_1__PM_STBY_MSK EQU 0x01

; Key_SCL
Key_SCL__0__INTTYPE EQU CYREG_PICU4_INTTYPE4
Key_SCL__0__MASK EQU 0x10
Key_SCL__0__PC EQU CYREG_PRT4_PC4
Key_SCL__0__PORT EQU 4
Key_SCL__0__SHIFT EQU 4
Key_SCL__AG EQU CYREG_PRT4_AG
Key_SCL__AMUX EQU CYREG_PRT4_AMUX
Key_SCL__BIE EQU CYREG_PRT4_BIE
Key_SCL__BIT_MASK EQU CYREG_PRT4_BIT_MASK
Key_SCL__BYP EQU CYREG_PRT4_BYP
Key_SCL__CTL EQU CYREG_PRT4_CTL
Key_SCL__DM0 EQU CYREG_PRT4_DM0
Key_SCL__DM1 EQU CYREG_PRT4_DM1
Key_SCL__DM2 EQU CYREG_PRT4_DM2
Key_SCL__DR EQU CYREG_PRT4_DR
Key_SCL__INP_DIS EQU CYREG_PRT4_INP_DIS
Key_SCL__INTTYPE_BASE EQU CYDEV_PICU_INTTYPE_PICU4_BASE
Key_SCL__LCD_COM_SEG EQU CYREG_PRT4_LCD_COM_SEG
Key_SCL__LCD_EN EQU CYREG_PRT4_LCD_EN
Key_SCL__MASK EQU 0x10
Key_SCL__PORT EQU 4
Key_SCL__PRT EQU CYREG_PRT4_PRT
Key_SCL__PRTDSI__CAPS_SEL EQU CYREG_PRT4_CAPS_SEL
Key_SCL__PRTDSI__DBL_SYNC_IN EQU CYREG_PRT4_DBL_SYNC_IN
Key_SCL__PRTDSI__OE_SEL0 EQU CYREG_PRT4_OE_SEL0
Key_SCL__PRTDSI__OE_SEL1 EQU CYREG_PRT4_OE_SEL1
Key_SCL__PRTDSI__OUT_SEL0 EQU CYREG_PRT4_OUT_SEL0
Key_SCL__PRTDSI__OUT_SEL1 EQU CYREG_PRT4_OUT_SEL1
Key_SCL__PRTDSI__SYNC_OUT EQU CYREG_PRT4_SYNC_OUT
Key_SCL__PS EQU CYREG_PRT4_PS
Key_SCL__SHIFT EQU 4
Key_SCL__SLW EQU CYREG_PRT4_SLW

; Key_SDA
Key_SDA__0__INTTYPE EQU CYREG_PICU4_INTTYPE5
Key_SDA__0__MASK EQU 0x20
Key_SDA__0__PC EQU CYREG_PRT4_PC5
Key_SDA__0__PORT EQU 4
Key_SDA__0__SHIFT EQU 5
Key_SDA__AG EQU CYREG_PRT4_AG
Key_SDA__AMUX EQU CYREG_PRT4_AMUX
Key_SDA__BIE EQU CYREG_PRT4_BIE
Key_SDA__BIT_MASK EQU CYREG_PRT4_BIT_MASK
Key_SDA__BYP EQU CYREG_PRT4_BYP
Key_SDA__CTL EQU CYREG_PRT4_CTL
Key_SDA__DM0 EQU CYREG_PRT4_DM0
Key_SDA__DM1 EQU CYREG_PRT4_DM1
Key_SDA__DM2 EQU CYREG_PRT4_DM2
Key_SDA__DR EQU CYREG_PRT4_DR
Key_SDA__INP_DIS EQU CYREG_PRT4_INP_DIS
Key_SDA__INTTYPE_BASE EQU CYDEV_PICU_INTTYPE_PICU4_BASE
Key_SDA__LCD_COM_SEG EQU CYREG_PRT4_LCD_COM_SEG
Key_SDA__LCD_EN EQU CYREG_PRT4_LCD_EN
Key_SDA__MASK EQU 0x20
Key_SDA__PORT EQU 4
Key_SDA__PRT EQU CYREG_PRT4_PRT
Key_SDA__PRTDSI__CAPS_SEL EQU CYREG_PRT4_CAPS_SEL
Key_SDA__PRTDSI__DBL_SYNC_IN EQU CYREG_PRT4_DBL_SYNC_IN
Key_SDA__PRTDSI__OE_SEL0 EQU CYREG_PRT4_OE_SEL0
Key_SDA__PRTDSI__OE_SEL1 EQU CYREG_PRT4_OE_SEL1
Key_SDA__PRTDSI__OUT_SEL0 EQU CYREG_PRT4_OUT_SEL0
Key_SDA__PRTDSI__OUT_SEL1 EQU CYREG_PRT4_OUT_SEL1
Key_SDA__PRTDSI__SYNC_OUT EQU CYREG_PRT4_SYNC_OUT
Key_SDA__PS EQU CYREG_PRT4_PS
Key_SDA__SHIFT EQU 5
Key_SDA__SLW EQU CYREG_PRT4_SLW

; Pin_Run
Pin_Run__0__INTTYPE EQU CYREG_PICU4_INTTYPE3
Pin_Run__0__MASK EQU 0x08
Pin_Run__0__PC EQU CYREG_PRT4_PC3
Pin_Run__0__PORT EQU 4
Pin_Run__0__SHIFT EQU 3
Pin_Run__AG EQU CYREG_PRT4_AG
Pin_Run__AMUX EQU CYREG_PRT4_AMUX
Pin_Run__BIE EQU CYREG_PRT4_BIE
Pin_Run__BIT_MASK EQU CYREG_PRT4_BIT_MASK
Pin_Run__BYP EQU CYREG_PRT4_BYP
Pin_Run__CTL EQU CYREG_PRT4_CTL
Pin_Run__DM0 EQU CYREG_PRT4_DM0
Pin_Run__DM1 EQU CYREG_PRT4_DM1
Pin_Run__DM2 EQU CYREG_PRT4_DM2
Pin_Run__DR EQU CYREG_PRT4_DR
Pin_Run__INP_DIS EQU CYREG_PRT4_INP_DIS
Pin_Run__INTTYPE_BASE EQU CYDEV_PICU_INTTYPE_PICU4_BASE
Pin_Run__LCD_COM_SEG EQU CYREG_PRT4_LCD_COM_SEG
Pin_Run__LCD_EN EQU CYREG_PRT4_LCD_EN
Pin_Run__MASK EQU 0x08
Pin_Run__PORT EQU 4
Pin_Run__PRT EQU CYREG_PRT4_PRT
Pin_Run__PRTDSI__CAPS_SEL EQU CYREG_PRT4_CAPS_SEL
Pin_Run__PRTDSI__DBL_SYNC_IN EQU CYREG_PRT4_DBL_SYNC_IN
Pin_Run__PRTDSI__OE_SEL0 EQU CYREG_PRT4_OE_SEL0
Pin_Run__PRTDSI__OE_SEL1 EQU CYREG_PRT4_OE_SEL1
Pin_Run__PRTDSI__OUT_SEL0 EQU CYREG_PRT4_OUT_SEL0
Pin_Run__PRTDSI__OUT_SEL1 EQU CYREG_PRT4_OUT_SEL1
Pin_Run__PRTDSI__SYNC_OUT EQU CYREG_PRT4_SYNC_OUT
Pin_Run__PS EQU CYREG_PRT4_PS
Pin_Run__SHIFT EQU 3
Pin_Run__SLW EQU CYREG_PRT4_SLW

; USBFS_1_arb_int
USBFS_1_arb_int__INTC_CLR_EN_REG EQU CYREG_NVIC_CLRENA0
USBFS_1_arb_int__INTC_CLR_PD_REG EQU CYREG_NVIC_CLRPEND0
USBFS_1_arb_int__INTC_MASK EQU 0x400000
USBFS_1_arb_int__INTC_NUMBER EQU 22
USBFS_1_arb_int__INTC_PRIOR_NUM EQU 7
USBFS_1_arb_int__INTC_PRIOR_REG EQU CYREG_NVIC_PRI_22
USBFS_1_arb_int__INTC_SET_EN_REG EQU CYREG_NVIC_SETENA0
USBFS_1_arb_int__INTC_SET_PD_REG EQU CYREG_NVIC_SETPEND0

; USBFS_1_bus_reset
USBFS_1_bus_reset__INTC_CLR_EN_REG EQU CYREG_NVIC_CLRENA0
USBFS_1_bus_reset__INTC_CLR_PD_REG EQU CYREG_NVIC_CLRPEND0
USBFS_1_bus_reset__INTC_MASK EQU 0x800000
USBFS_1_bus_reset__INTC_NUMBER EQU 23
USBFS_1_bus_reset__INTC_PRIOR_NUM EQU 7
USBFS_1_bus_reset__INTC_PRIOR_REG EQU CYREG_NVIC_PRI_23
USBFS_1_bus_reset__INTC_SET_EN_REG EQU CYREG_NVIC_SETENA0
USBFS_1_bus_reset__INTC_SET_PD_REG EQU CYREG_NVIC_SETPEND0

; USBFS_1_Dm
USBFS_1_Dm__0__INTTYPE EQU CYREG_PICU15_INTTYPE7
USBFS_1_Dm__0__MASK EQU 0x80
USBFS_1_Dm__0__PC EQU CYREG_IO_PC_PRT15_7_6_PC1
USBFS_1_Dm__0__PORT EQU 15
USBFS_1_Dm__0__SHIFT EQU 7
USBFS_1_Dm__AG EQU CYREG_PRT15_AG
USBFS_1_Dm__AMUX EQU CYREG_PRT15_AMUX
USBFS_1_Dm__BIE EQU CYREG_PRT15_BIE
USBFS_1_Dm__BIT_MASK EQU CYREG_PRT15_BIT_MASK
USBFS_1_Dm__BYP EQU CYREG_PRT15_BYP
USBFS_1_Dm__CTL EQU CYREG_PRT15_CTL
USBFS_1_Dm__DM0 EQU CYREG_PRT15_DM0
USBFS_1_Dm__DM1 EQU CYREG_PRT15_DM1
USBFS_1_Dm__DM2 EQU CYREG_PRT15_DM2
USBFS_1_Dm__DR EQU CYREG_PRT15_DR
USBFS_1_Dm__INP_DIS EQU CYREG_PRT15_INP_DIS
USBFS_1_Dm__INTTYPE_BASE EQU CYDEV_PICU_INTTYPE_PICU15_BASE
USBFS_1_Dm__LCD_COM_SEG EQU CYREG_PRT15_LCD_COM_SEG
USBFS_1_Dm__LCD_EN EQU CYREG_PRT15_LCD_EN
USBFS_1_Dm__MASK EQU 0x80
USBFS_1_Dm__PORT EQU 15
USBFS_1_Dm__PRT EQU CYREG_PRT15_PRT
USBFS_1_Dm__PRTDSI__CAPS_SEL EQU CYREG_PRT15_CAPS_SEL
USBFS_1_Dm__PRTDSI__DBL_SYNC_IN EQU CYREG_PRT15_DBL_SYNC_IN
USBFS_1_Dm__PRTDSI__OE_SEL0 EQU CYREG_PRT15_OE_SEL0
USBFS_1_Dm__PRTDSI__OE_SEL1 EQU CYREG_PRT15_OE_SEL1
USBFS_1_Dm__PRTDSI__OUT_SEL0 EQU CYREG_PRT15_OUT_SEL0
USBFS_1_Dm__PRTDSI__OUT_SEL1 EQU CYREG_PRT15_OUT_SEL1
USBFS_1_Dm__PRTDSI__SYNC_OUT EQU CYREG_PRT15_SYNC_OUT
USBFS_1_Dm__PS EQU CYREG_PRT15_PS
USBFS_1_Dm__SHIFT EQU 7
USBFS_1_Dm__SLW EQU CYREG_PRT15_SLW

; USBFS_1_Dp
USBFS_1_Dp__0__INTTYPE EQU CYREG_PICU15_INTTYPE6
USBFS_1_Dp__0__MASK EQU 0x40
USBFS_1_Dp__0__PC EQU CYREG_IO_PC_PRT15_7_6_PC0
USBFS_1_Dp__0__PORT EQU 15
USBFS_1_Dp__0__SHIFT EQU 6
USBFS_1_Dp__AG EQU CYREG_PRT15_AG
USBFS_1_Dp__AMUX EQU CYREG_PRT15_AMUX
USBFS_1_Dp__BIE EQU CYREG_PRT15_BIE
USBFS_1_Dp__BIT_MASK EQU CYREG_PRT15_BIT_MASK
USBFS_1_Dp__BYP EQU CYREG_PRT15_BYP
USBFS_1_Dp__CTL EQU CYREG_PRT15_CTL
USBFS_1_Dp__DM0 EQU CYREG_PRT15_DM0
USBFS_1_Dp__DM1 EQU CYREG_PRT15_DM1
USBFS_1_Dp__DM2 EQU CYREG_PRT15_DM2
USBFS_1_Dp__DR EQU CYREG_PRT15_DR
USBFS_1_Dp__INP_DIS EQU CYREG_PRT15_INP_DIS
USBFS_1_Dp__INTSTAT EQU CYREG_PICU15_INTSTAT
USBFS_1_Dp__INTTYPE_BASE EQU CYDEV_PICU_INTTYPE_PICU15_BASE
USBFS_1_Dp__LCD_COM_SEG EQU CYREG_PRT15_LCD_COM_SEG
USBFS_1_Dp__LCD_EN EQU CYREG_PRT15_LCD_EN
USBFS_1_Dp__MASK EQU 0x40
USBFS_1_Dp__PORT EQU 15
USBFS_1_Dp__PRT EQU CYREG_PRT15_PRT
USBFS_1_Dp__PRTDSI__CAPS_SEL EQU CYREG_PRT15_CAPS_SEL
USBFS_1_Dp__PRTDSI__DBL_SYNC_IN EQU CYREG_PRT15_DBL_SYNC_IN
USBFS_1_Dp__PRTDSI__OE_SEL0 EQU CYREG_PRT15_OE_SEL0
USBFS_1_Dp__PRTDSI__OE_SEL1 EQU CYREG_PRT15_OE_SEL1
USBFS_1_Dp__PRTDSI__OUT_SEL0 EQU CYREG_PRT15_OUT_SEL0
USBFS_1_Dp__PRTDSI__OUT_SEL1 EQU CYREG_PRT15_OUT_SEL1
USBFS_1_Dp__PRTDSI__SYNC_OUT EQU CYREG_PRT15_SYNC_OUT
USBFS_1_Dp__PS EQU CYREG_PRT15_PS
USBFS_1_Dp__SHIFT EQU 6
USBFS_1_Dp__SLW EQU CYREG_PRT15_SLW
USBFS_1_Dp__SNAP EQU CYREG_PICU_15_SNAP_15

; USBFS_1_dp_int
USBFS_1_dp_int__INTC_CLR_EN_REG EQU CYREG_NVIC_CLRENA0
USBFS_1_dp_int__INTC_CLR_PD_REG EQU CYREG_NVIC_CLRPEND0
USBFS_1_dp_int__INTC_MASK EQU 0x1000
USBFS_1_dp_int__INTC_NUMBER EQU 12
USBFS_1_dp_int__INTC_PRIOR_NUM EQU 7
USBFS_1_dp_int__INTC_PRIOR_REG EQU CYREG_NVIC_PRI_12
USBFS_1_dp_int__INTC_SET_EN_REG EQU CYREG_NVIC_SETENA0
USBFS_1_dp_int__INTC_SET_PD_REG EQU CYREG_NVIC_SETPEND0

; USBFS_1_ep_0
USBFS_1_ep_0__INTC_CLR_EN_REG EQU CYREG_NVIC_CLRENA0
USBFS_1_ep_0__INTC_CLR_PD_REG EQU CYREG_NVIC_CLRPEND0
USBFS_1_ep_0__INTC_MASK EQU 0x1000000
USBFS_1_ep_0__INTC_NUMBER EQU 24
USBFS_1_ep_0__INTC_PRIOR_NUM EQU 7
USBFS_1_ep_0__INTC_PRIOR_REG EQU CYREG_NVIC_PRI_24
USBFS_1_ep_0__INTC_SET_EN_REG EQU CYREG_NVIC_SETENA0
USBFS_1_ep_0__INTC_SET_PD_REG EQU CYREG_NVIC_SETPEND0

; USBFS_1_ep_1
USBFS_1_ep_1__INTC_CLR_EN_REG EQU CYREG_NVIC_CLRENA0
USBFS_1_ep_1__INTC_CLR_PD_REG EQU CYREG_NVIC_CLRPEND0
USBFS_1_ep_1__INTC_MASK EQU 0x01
USBFS_1_ep_1__INTC_NUMBER EQU 0
USBFS_1_ep_1__INTC_PRIOR_NUM EQU 7
USBFS_1_ep_1__INTC_PRIOR_REG EQU CYREG_NVIC_PRI_0
USBFS_1_ep_1__INTC_SET_EN_REG EQU CYREG_NVIC_SETENA0
USBFS_1_ep_1__INTC_SET_PD_REG EQU CYREG_NVIC_SETPEND0

; USBFS_1_ep_2
USBFS_1_ep_2__INTC_CLR_EN_REG EQU CYREG_NVIC_CLRENA0
USBFS_1_ep_2__INTC_CLR_PD_REG EQU CYREG_NVIC_CLRPEND0
USBFS_1_ep_2__INTC_MASK EQU 0x02
USBFS_1_ep_2__INTC_NUMBER EQU 1
USBFS_1_ep_2__INTC_PRIOR_NUM EQU 7
USBFS_1_ep_2__INTC_PRIOR_REG EQU CYREG_NVIC_PRI_1
USBFS_1_ep_2__INTC_SET_EN_REG EQU CYREG_NVIC_SETENA0
USBFS_1_ep_2__INTC_SET_PD_REG EQU CYREG_NVIC_SETPEND0

; USBFS_1_sof_int
USBFS_1_sof_int__INTC_CLR_EN_REG EQU CYREG_NVIC_CLRENA0
USBFS_1_sof_int__INTC_CLR_PD_REG EQU CYREG_NVIC_CLRPEND0
USBFS_1_sof_int__INTC_MASK EQU 0x200000
USBFS_1_sof_int__INTC_NUMBER EQU 21
USBFS_1_sof_int__INTC_PRIOR_NUM EQU 7
USBFS_1_sof_int__INTC_PRIOR_REG EQU CYREG_NVIC_PRI_21
USBFS_1_sof_int__INTC_SET_EN_REG EQU CYREG_NVIC_SETENA0
USBFS_1_sof_int__INTC_SET_PD_REG EQU CYREG_NVIC_SETPEND0

; USBFS_1_USB
USBFS_1_USB__ARB_CFG EQU CYREG_USB_ARB_CFG
USBFS_1_USB__ARB_EP1_CFG EQU CYREG_USB_ARB_EP1_CFG
USBFS_1_USB__ARB_EP1_INT_EN EQU CYREG_USB_ARB_EP1_INT_EN
USBFS_1_USB__ARB_EP1_SR EQU CYREG_USB_ARB_EP1_SR
USBFS_1_USB__ARB_EP2_CFG EQU CYREG_USB_ARB_EP2_CFG
USBFS_1_USB__ARB_EP2_INT_EN EQU CYREG_USB_ARB_EP2_INT_EN
USBFS_1_USB__ARB_EP2_SR EQU CYREG_USB_ARB_EP2_SR
USBFS_1_USB__ARB_EP3_CFG EQU CYREG_USB_ARB_EP3_CFG
USBFS_1_USB__ARB_EP3_INT_EN EQU CYREG_USB_ARB_EP3_INT_EN
USBFS_1_USB__ARB_EP3_SR EQU CYREG_USB_ARB_EP3_SR
USBFS_1_USB__ARB_EP4_CFG EQU CYREG_USB_ARB_EP4_CFG
USBFS_1_USB__ARB_EP4_INT_EN EQU CYREG_USB_ARB_EP4_INT_EN
USBFS_1_USB__ARB_EP4_SR EQU CYREG_USB_ARB_EP4_SR
USBFS_1_USB__ARB_EP5_CFG EQU CYREG_USB_ARB_EP5_CFG
USBFS_1_USB__ARB_EP5_INT_EN EQU CYREG_USB_ARB_EP5_INT_EN
USBFS_1_USB__ARB_EP5_SR EQU CYREG_USB_ARB_EP5_SR
USBFS_1_USB__ARB_EP6_CFG EQU CYREG_USB_ARB_EP6_CFG
USBFS_1_USB__ARB_EP6_INT_EN EQU CYREG_USB_ARB_EP6_INT_EN
USBFS_1_USB__ARB_EP6_SR EQU CYREG_USB_ARB_EP6_SR
USBFS_1_USB__ARB_EP7_CFG EQU CYREG_USB_ARB_EP7_CFG
USBFS_1_USB__ARB_EP7_INT_EN EQU CYREG_USB_ARB_EP7_INT_EN
USBFS_1_USB__ARB_EP7_SR EQU CYREG_USB_ARB_EP7_SR
USBFS_1_USB__ARB_EP8_CFG EQU CYREG_USB_ARB_EP8_CFG
USBFS_1_USB__ARB_EP8_INT_EN EQU CYREG_USB_ARB_EP8_INT_EN
USBFS_1_USB__ARB_EP8_SR EQU CYREG_USB_ARB_EP8_SR
USBFS_1_USB__ARB_INT_EN EQU CYREG_USB_ARB_INT_EN
USBFS_1_USB__ARB_INT_SR EQU CYREG_USB_ARB_INT_SR
USBFS_1_USB__ARB_RW1_DR EQU CYREG_USB_ARB_RW1_DR
USBFS_1_USB__ARB_RW1_RA EQU CYREG_USB_ARB_RW1_RA
USBFS_1_USB__ARB_RW1_RA_MSB EQU CYREG_USB_ARB_RW1_RA_MSB
USBFS_1_USB__ARB_RW1_WA EQU CYREG_USB_ARB_RW1_WA
USBFS_1_USB__ARB_RW1_WA_MSB EQU CYREG_USB_ARB_RW1_WA_MSB
USBFS_1_USB__ARB_RW2_DR EQU CYREG_USB_ARB_RW2_DR
USBFS_1_USB__ARB_RW2_RA EQU CYREG_USB_ARB_RW2_RA
USBFS_1_USB__ARB_RW2_RA_MSB EQU CYREG_USB_ARB_RW2_RA_MSB
USBFS_1_USB__ARB_RW2_WA EQU CYREG_USB_ARB_RW2_WA
USBFS_1_USB__ARB_RW2_WA_MSB EQU CYREG_USB_ARB_RW2_WA_MSB
USBFS_1_USB__ARB_RW3_DR EQU CYREG_USB_ARB_RW3_DR
USBFS_1_USB__ARB_RW3_RA EQU CYREG_USB_ARB_RW3_RA
USBFS_1_USB__ARB_RW3_RA_MSB EQU CYREG_USB_ARB_RW3_RA_MSB
USBFS_1_USB__ARB_RW3_WA EQU CYREG_USB_ARB_RW3_WA
USBFS_1_USB__ARB_RW3_WA_MSB EQU CYREG_USB_ARB_RW3_WA_MSB
USBFS_1_USB__ARB_RW4_DR EQU CYREG_USB_ARB_RW4_DR
USBFS_1_USB__ARB_RW4_RA EQU CYREG_USB_ARB_RW4_RA
USBFS_1_USB__ARB_RW4_RA_MSB EQU CYREG_USB_ARB_RW4_RA_MSB
USBFS_1_USB__ARB_RW4_WA EQU CYREG_USB_ARB_RW4_WA
USBFS_1_USB__ARB_RW4_WA_MSB EQU CYREG_USB_ARB_RW4_WA_MSB
USBFS_1_USB__ARB_RW5_DR EQU CYREG_USB_ARB_RW5_DR
USBFS_1_USB__ARB_RW5_RA EQU CYREG_USB_ARB_RW5_RA
USBFS_1_USB__ARB_RW5_RA_MSB EQU CYREG_USB_ARB_RW5_RA_MSB
USBFS_1_USB__ARB_RW5_WA EQU CYREG_USB_ARB_RW5_WA
USBFS_1_USB__ARB_RW5_WA_MSB EQU CYREG_USB_ARB_RW5_WA_MSB
USBFS_1_USB__ARB_RW6_DR EQU CYREG_USB_ARB_RW6_DR
USBFS_1_USB__ARB_RW6_RA EQU CYREG_USB_ARB_RW6_RA
USBFS_1_USB__ARB_RW6_RA_MSB EQU CYREG_USB_ARB_RW6_RA_MSB
USBFS_1_USB__ARB_RW6_WA EQU CYREG_USB_ARB_RW6_WA
USBFS_1_USB__ARB_RW6_WA_MSB EQU CYREG_USB_ARB_RW6_WA_MSB
USBFS_1_USB__ARB_RW7_DR EQU CYREG_USB_ARB_RW7_DR
USBFS_1_USB__ARB_RW7_RA EQU CYREG_USB_ARB_RW7_RA
USBFS_1_USB__ARB_RW7_RA_MSB EQU CYREG_USB_ARB_RW7_RA_MSB
USBFS_1_USB__ARB_RW7_WA EQU CYREG_USB_ARB_RW7_WA
USBFS_1_USB__ARB_RW7_WA_MSB EQU CYREG_USB_ARB_RW7_WA_MSB
USBFS_1_USB__ARB_RW8_DR EQU CYREG_USB_ARB_RW8_DR
USBFS_1_USB__ARB_RW8_RA EQU CYREG_USB_ARB_RW8_RA
USBFS_1_USB__ARB_RW8_RA_MSB EQU CYREG_USB_ARB_RW8_RA_MSB
USBFS_1_USB__ARB_RW8_WA EQU CYREG_USB_ARB_RW8_WA
USBFS_1_USB__ARB_RW8_WA_MSB EQU CYREG_USB_ARB_RW8_WA_MSB
USBFS_1_USB__BUF_SIZE EQU CYREG_USB_BUF_SIZE
USBFS_1_USB__BUS_RST_CNT EQU CYREG_USB_BUS_RST_CNT
USBFS_1_USB__CR0 EQU CYREG_USB_CR0
USBFS_1_USB__CR1 EQU CYREG_USB_CR1
USBFS_1_USB__CWA EQU CYREG_USB_CWA
USBFS_1_USB__CWA_MSB EQU CYREG_USB_CWA_MSB
USBFS_1_USB__DMA_THRES EQU CYREG_USB_DMA_THRES
USBFS_1_USB__DMA_THRES_MSB EQU CYREG_USB_DMA_THRES_MSB
USBFS_1_USB__DYN_RECONFIG EQU CYREG_USB_DYN_RECONFIG
USBFS_1_USB__EP_ACTIVE EQU CYREG_USB_EP_ACTIVE
USBFS_1_USB__EP_TYPE EQU CYREG_USB_EP_TYPE
USBFS_1_USB__EP0_CNT EQU CYREG_USB_EP0_CNT
USBFS_1_USB__EP0_CR EQU CYREG_USB_EP0_CR
USBFS_1_USB__EP0_DR0 EQU CYREG_USB_EP0_DR0
USBFS_1_USB__EP0_DR1 EQU CYREG_USB_EP0_DR1
USBFS_1_USB__EP0_DR2 EQU CYREG_USB_EP0_DR2
USBFS_1_USB__EP0_DR3 EQU CYREG_USB_EP0_DR3
USBFS_1_USB__EP0_DR4 EQU CYREG_USB_EP0_DR4
USBFS_1_USB__EP0_DR5 EQU CYREG_USB_EP0_DR5
USBFS_1_USB__EP0_DR6 EQU CYREG_USB_EP0_DR6
USBFS_1_USB__EP0_DR7 EQU CYREG_USB_EP0_DR7
USBFS_1_USB__MEM_DATA EQU CYREG_USB_MEM_DATA_MBASE
USBFS_1_USB__PM_ACT_CFG EQU CYREG_PM_ACT_CFG5
USBFS_1_USB__PM_ACT_MSK EQU 0x01
USBFS_1_USB__PM_STBY_CFG EQU CYREG_PM_STBY_CFG5
USBFS_1_USB__PM_STBY_MSK EQU 0x01
USBFS_1_USB__SIE_EP_INT_EN EQU CYREG_USB_SIE_EP_INT_EN
USBFS_1_USB__SIE_EP_INT_SR EQU CYREG_USB_SIE_EP_INT_SR
USBFS_1_USB__SIE_EP1_CNT0 EQU CYREG_USB_SIE_EP1_CNT0
USBFS_1_USB__SIE_EP1_CNT1 EQU CYREG_USB_SIE_EP1_CNT1
USBFS_1_USB__SIE_EP1_CR0 EQU CYREG_USB_SIE_EP1_CR0
USBFS_1_USB__SIE_EP2_CNT0 EQU CYREG_USB_SIE_EP2_CNT0
USBFS_1_USB__SIE_EP2_CNT1 EQU CYREG_USB_SIE_EP2_CNT1
USBFS_1_USB__SIE_EP2_CR0 EQU CYREG_USB_SIE_EP2_CR0
USBFS_1_USB__SIE_EP3_CNT0 EQU CYREG_USB_SIE_EP3_CNT0
USBFS_1_USB__SIE_EP3_CNT1 EQU CYREG_USB_SIE_EP3_CNT1
USBFS_1_USB__SIE_EP3_CR0 EQU CYREG_USB_SIE_EP3_CR0
USBFS_1_USB__SIE_EP4_CNT0 EQU CYREG_USB_SIE_EP4_CNT0
USBFS_1_USB__SIE_EP4_CNT1 EQU CYREG_USB_SIE_EP4_CNT1
USBFS_1_USB__SIE_EP4_CR0 EQU CYREG_USB_SIE_EP4_CR0
USBFS_1_USB__SIE_EP5_CNT0 EQU CYREG_USB_SIE_EP5_CNT0
USBFS_1_USB__SIE_EP5_CNT1 EQU CYREG_USB_SIE_EP5_CNT1
USBFS_1_USB__SIE_EP5_CR0 EQU CYREG_USB_SIE_EP5_CR0
USBFS_1_USB__SIE_EP6_CNT0 EQU CYREG_USB_SIE_EP6_CNT0
USBFS_1_USB__SIE_EP6_CNT1 EQU CYREG_USB_SIE_EP6_CNT1
USBFS_1_USB__SIE_EP6_CR0 EQU CYREG_USB_SIE_EP6_CR0
USBFS_1_USB__SIE_EP7_CNT0 EQU CYREG_USB_SIE_EP7_CNT0
USBFS_1_USB__SIE_EP7_CNT1 EQU CYREG_USB_SIE_EP7_CNT1
USBFS_1_USB__SIE_EP7_CR0 EQU CYREG_USB_SIE_EP7_CR0
USBFS_1_USB__SIE_EP8_CNT0 EQU CYREG_USB_SIE_EP8_CNT0
USBFS_1_USB__SIE_EP8_CNT1 EQU CYREG_USB_SIE_EP8_CNT1
USBFS_1_USB__SIE_EP8_CR0 EQU CYREG_USB_SIE_EP8_CR0
USBFS_1_USB__SOF0 EQU CYREG_USB_SOF0
USBFS_1_USB__SOF1 EQU CYREG_USB_SOF1
USBFS_1_USB__USB_CLK_EN EQU CYREG_USB_USB_CLK_EN
USBFS_1_USB__USBIO_CR0 EQU CYREG_USB_USBIO_CR0
USBFS_1_USB__USBIO_CR1 EQU CYREG_USB_USBIO_CR1

; Pin_Stop
Pin_Stop__0__INTTYPE EQU CYREG_PICU4_INTTYPE2
Pin_Stop__0__MASK EQU 0x04
Pin_Stop__0__PC EQU CYREG_PRT4_PC2
Pin_Stop__0__PORT EQU 4
Pin_Stop__0__SHIFT EQU 2
Pin_Stop__AG EQU CYREG_PRT4_AG
Pin_Stop__AMUX EQU CYREG_PRT4_AMUX
Pin_Stop__BIE EQU CYREG_PRT4_BIE
Pin_Stop__BIT_MASK EQU CYREG_PRT4_BIT_MASK
Pin_Stop__BYP EQU CYREG_PRT4_BYP
Pin_Stop__CTL EQU CYREG_PRT4_CTL
Pin_Stop__DM0 EQU CYREG_PRT4_DM0
Pin_Stop__DM1 EQU CYREG_PRT4_DM1
Pin_Stop__DM2 EQU CYREG_PRT4_DM2
Pin_Stop__DR EQU CYREG_PRT4_DR
Pin_Stop__INP_DIS EQU CYREG_PRT4_INP_DIS
Pin_Stop__INTTYPE_BASE EQU CYDEV_PICU_INTTYPE_PICU4_BASE
Pin_Stop__LCD_COM_SEG EQU CYREG_PRT4_LCD_COM_SEG
Pin_Stop__LCD_EN EQU CYREG_PRT4_LCD_EN
Pin_Stop__MASK EQU 0x04
Pin_Stop__PORT EQU 4
Pin_Stop__PRT EQU CYREG_PRT4_PRT
Pin_Stop__PRTDSI__CAPS_SEL EQU CYREG_PRT4_CAPS_SEL
Pin_Stop__PRTDSI__DBL_SYNC_IN EQU CYREG_PRT4_DBL_SYNC_IN
Pin_Stop__PRTDSI__OE_SEL0 EQU CYREG_PRT4_OE_SEL0
Pin_Stop__PRTDSI__OE_SEL1 EQU CYREG_PRT4_OE_SEL1
Pin_Stop__PRTDSI__OUT_SEL0 EQU CYREG_PRT4_OUT_SEL0
Pin_Stop__PRTDSI__OUT_SEL1 EQU CYREG_PRT4_OUT_SEL1
Pin_Stop__PRTDSI__SYNC_OUT EQU CYREG_PRT4_SYNC_OUT
Pin_Stop__PS EQU CYREG_PRT4_PS
Pin_Stop__SHIFT EQU 2
Pin_Stop__SLW EQU CYREG_PRT4_SLW

; Control_Reg_1
Control_Reg_1_Sync_ctrl_reg__0__MASK EQU 0x01
Control_Reg_1_Sync_ctrl_reg__0__POS EQU 0
Control_Reg_1_Sync_ctrl_reg__16BIT_CONTROL_AUX_CTL_REG EQU CYREG_B0_UDB01_02_ACTL
Control_Reg_1_Sync_ctrl_reg__16BIT_CONTROL_CONTROL_REG EQU CYREG_B0_UDB01_02_CTL
Control_Reg_1_Sync_ctrl_reg__16BIT_CONTROL_COUNT_REG EQU CYREG_B0_UDB01_02_CTL
Control_Reg_1_Sync_ctrl_reg__16BIT_COUNT_CONTROL_REG EQU CYREG_B0_UDB01_02_CTL
Control_Reg_1_Sync_ctrl_reg__16BIT_COUNT_COUNT_REG EQU CYREG_B0_UDB01_02_CTL
Control_Reg_1_Sync_ctrl_reg__16BIT_MASK_MASK_REG EQU CYREG_B0_UDB01_02_MSK
Control_Reg_1_Sync_ctrl_reg__16BIT_MASK_PERIOD_REG EQU CYREG_B0_UDB01_02_MSK
Control_Reg_1_Sync_ctrl_reg__16BIT_PERIOD_MASK_REG EQU CYREG_B0_UDB01_02_MSK
Control_Reg_1_Sync_ctrl_reg__16BIT_PERIOD_PERIOD_REG EQU CYREG_B0_UDB01_02_MSK
Control_Reg_1_Sync_ctrl_reg__CONTROL_AUX_CTL_REG EQU CYREG_B0_UDB01_ACTL
Control_Reg_1_Sync_ctrl_reg__CONTROL_REG EQU CYREG_B0_UDB01_CTL
Control_Reg_1_Sync_ctrl_reg__CONTROL_ST_REG EQU CYREG_B0_UDB01_ST_CTL
Control_Reg_1_Sync_ctrl_reg__COUNT_REG EQU CYREG_B0_UDB01_CTL
Control_Reg_1_Sync_ctrl_reg__COUNT_ST_REG EQU CYREG_B0_UDB01_ST_CTL
Control_Reg_1_Sync_ctrl_reg__MASK EQU 0x01
Control_Reg_1_Sync_ctrl_reg__MASK_CTL_AUX_CTL_REG EQU CYREG_B0_UDB01_MSK_ACTL
Control_Reg_1_Sync_ctrl_reg__PER_CTL_AUX_CTL_REG EQU CYREG_B0_UDB01_MSK_ACTL
Control_Reg_1_Sync_ctrl_reg__PERIOD_REG EQU CYREG_B0_UDB01_MSK

; Miscellaneous
BCLK__BUS_CLK__HZ EQU 64000000
BCLK__BUS_CLK__KHZ EQU 64000
BCLK__BUS_CLK__MHZ EQU 64
CYDEV_BOOTLOADER_APPLICATIONS EQU 1
CYDEV_BOOTLOADER_CHECKSUM_BASIC EQU 0
CYDEV_BOOTLOADER_CHECKSUM_CRC EQU 1
CYDEV_BOOTLOADER_IO_COMP_CUSTOM_IO EQU 0
CyBtldr_Custom_Interface EQU CYDEV_BOOTLOADER_IO_COMP_CUSTOM_IO
CYDEV_BOOTLOADER_IO_COMP_USBFS_1 EQU 1
CyBtldr_USBFS_1 EQU CYDEV_BOOTLOADER_IO_COMP_USBFS_1
CYDEV_BOOTLOADER_IO_COMP EQU CYDEV_BOOTLOADER_IO_COMP_USBFS_1
CYDEV_CHIP_DIE_LEOPARD EQU 1
CYDEV_CHIP_DIE_PANTHER EQU 18
CYDEV_CHIP_DIE_PSOC4A EQU 10
CYDEV_CHIP_DIE_PSOC5LP EQU 17
CYDEV_CHIP_DIE_TMA4 EQU 2
CYDEV_CHIP_DIE_UNKNOWN EQU 0
CYDEV_CHIP_FAMILY_PSOC3 EQU 1
CYDEV_CHIP_FAMILY_PSOC4 EQU 2
CYDEV_CHIP_FAMILY_PSOC5 EQU 3
CYDEV_CHIP_FAMILY_UNKNOWN EQU 0
CYDEV_CHIP_FAMILY_USED EQU CYDEV_CHIP_FAMILY_PSOC5
CYDEV_CHIP_JTAG_ID EQU 0x2E133069
CYDEV_CHIP_MEMBER_3A EQU 1
CYDEV_CHIP_MEMBER_4A EQU 10
CYDEV_CHIP_MEMBER_4C EQU 15
CYDEV_CHIP_MEMBER_4D EQU 6
CYDEV_CHIP_MEMBER_4E EQU 4
CYDEV_CHIP_MEMBER_4F EQU 11
CYDEV_CHIP_MEMBER_4G EQU 2
CYDEV_CHIP_MEMBER_4H EQU 9
CYDEV_CHIP_MEMBER_4I EQU 14
CYDEV_CHIP_MEMBER_4J EQU 7
CYDEV_CHIP_MEMBER_4K EQU 8
CYDEV_CHIP_MEMBER_4L EQU 13
CYDEV_CHIP_MEMBER_4M EQU 12
CYDEV_CHIP_MEMBER_4N EQU 5
CYDEV_CHIP_MEMBER_4U EQU 3
CYDEV_CHIP_MEMBER_5A EQU 17
CYDEV_CHIP_MEMBER_5B EQU 16
CYDEV_CHIP_MEMBER_UNKNOWN EQU 0
CYDEV_CHIP_MEMBER_USED EQU CYDEV_CHIP_MEMBER_5B
CYDEV_CHIP_DIE_EXPECT EQU CYDEV_CHIP_MEMBER_USED
CYDEV_CHIP_DIE_ACTUAL EQU CYDEV_CHIP_DIE_EXPECT
CYDEV_CHIP_REV_LEOPARD_ES1 EQU 0
CYDEV_CHIP_REV_LEOPARD_ES2 EQU 1
CYDEV_CHIP_REV_LEOPARD_ES3 EQU 3
CYDEV_CHIP_REV_LEOPARD_PRODUCTION EQU 3
CYDEV_CHIP_REV_PANTHER_ES0 EQU 0
CYDEV_CHIP_REV_PANTHER_ES1 EQU 1
CYDEV_CHIP_REV_PANTHER_PRODUCTION EQU 1
CYDEV_CHIP_REV_PSOC4A_ES0 EQU 17
CYDEV_CHIP_REV_PSOC4A_PRODUCTION EQU 17
CYDEV_CHIP_REV_PSOC5LP_ES0 EQU 0
CYDEV_CHIP_REV_PSOC5LP_PRODUCTION EQU 0
CYDEV_CHIP_REV_TMA4_ES EQU 17
CYDEV_CHIP_REV_TMA4_ES2 EQU 33
CYDEV_CHIP_REV_TMA4_PRODUCTION EQU 17
CYDEV_CHIP_REVISION_3A_ES1 EQU 0
CYDEV_CHIP_REVISION_3A_ES2 EQU 1
CYDEV_CHIP_REVISION_3A_ES3 EQU 3
CYDEV_CHIP_REVISION_3A_PRODUCTION EQU 3
CYDEV_CHIP_REVISION_4A_ES0 EQU 17
CYDEV_CHIP_REVISION_4A_PRODUCTION EQU 17
CYDEV_CHIP_REVISION_4C_PRODUCTION EQU 0
CYDEV_CHIP_REVISION_4D_PRODUCTION EQU 0
CYDEV_CHIP_REVISION_4E_PRODUCTION EQU 0
CYDEV_CHIP_REVISION_4F_PRODUCTION EQU 0
CYDEV_CHIP_REVISION_4F_PRODUCTION_256DMA EQU 0
CYDEV_CHIP_REVISION_4F_PRODUCTION_256K EQU 0
CYDEV_CHIP_REVISION_4G_ES EQU 17
CYDEV_CHIP_REVISION_4G_ES2 EQU 33
CYDEV_CHIP_REVISION_4G_PRODUCTION EQU 17
CYDEV_CHIP_REVISION_4H_PRODUCTION EQU 0
CYDEV_CHIP_REVISION_4I_PRODUCTION EQU 0
CYDEV_CHIP_REVISION_4J_PRODUCTION EQU 0
CYDEV_CHIP_REVISION_4K_PRODUCTION EQU 0
CYDEV_CHIP_REVISION_4L_PRODUCTION EQU 0
CYDEV_CHIP_REVISION_4M_PRODUCTION EQU 0
CYDEV_CHIP_REVISION_4N_PRODUCTION EQU 0
CYDEV_CHIP_REVISION_4U_PRODUCTION EQU 0
CYDEV_CHIP_REVISION_5A_ES0 EQU 0
CYDEV_CHIP_REVISION_5A_ES1 EQU 1
CYDEV_CHIP_REVISION_5A_PRODUCTION EQU 1
CYDEV_CHIP_REVISION_5B_ES0 EQU 0
CYDEV_CHIP_REVISION_5B_PRODUCTION EQU 0
CYDEV_CHIP_REVISION_USED EQU CYDEV_CHIP_REVISION_5B_PRODUCTION
CYDEV_CHIP_REV_EXPECT EQU CYDEV_CHIP_REVISION_USED
CYDEV_CONFIG_FASTBOOT_ENABLED EQU 1
CYDEV_CONFIG_UNUSED_IO_AllowButWarn EQU 0
CYDEV_CONFIG_UNUSED_IO EQU CYDEV_CONFIG_UNUSED_IO_AllowButWarn
CYDEV_CONFIG_UNUSED_IO_AllowWithInfo EQU 1
CYDEV_CONFIG_UNUSED_IO_Disallowed EQU 2
CYDEV_CONFIGURATION_COMPRESSED EQU 1
CYDEV_CONFIGURATION_DMA EQU 0
CYDEV_CONFIGURATION_ECC EQU 1
CYDEV_CONFIGURATION_IMOENABLED EQU CYDEV_CONFIG_FASTBOOT_ENABLED
CYDEV_CONFIGURATION_MODE_COMPRESSED EQU 0
CYDEV_CONFIGURATION_MODE EQU CYDEV_CONFIGURATION_MODE_COMPRESSED
CYDEV_CONFIGURATION_MODE_DMA EQU 2
CYDEV_CONFIGURATION_MODE_UNCOMPRESSED EQU 1
CYDEV_DEBUG_ENABLE_MASK EQU 0x20
CYDEV_DEBUG_ENABLE_REGISTER EQU CYREG_MLOGIC_DEBUG
CYDEV_DEBUGGING_DPS_Disable EQU 3
CYDEV_DEBUGGING_DPS EQU CYDEV_DEBUGGING_DPS_Disable
CYDEV_DEBUGGING_DPS_JTAG_4 EQU 1
CYDEV_DEBUGGING_DPS_JTAG_5 EQU 0
CYDEV_DEBUGGING_DPS_SWD EQU 2
CYDEV_DEBUGGING_DPS_SWD_SWV EQU 6
CYDEV_DEBUGGING_ENABLE EQU 1
CYDEV_DEBUGGING_XRES EQU 0
CYDEV_DMA_CHANNELS_AVAILABLE EQU 24
CYDEV_ECC_ENABLE EQU 0
CYDEV_HEAP_SIZE EQU 0x0800
CYDEV_INSTRUCT_CACHE_ENABLED EQU 1
CYDEV_INTR_RISING EQU 0x00000000
CYDEV_IS_EXPORTING_CODE EQU 0
CYDEV_IS_IMPORTING_CODE EQU 0
CYDEV_PROJ_TYPE EQU 1
CYDEV_PROJ_TYPE_BOOTLOADER EQU 1
CYDEV_PROJ_TYPE_LAUNCHER EQU 5
CYDEV_PROJ_TYPE_LOADABLE EQU 2
CYDEV_PROJ_TYPE_LOADABLEANDBOOTLOADER EQU 4
CYDEV_PROJ_TYPE_MULTIAPPBOOTLOADER EQU 3
CYDEV_PROJ_TYPE_STANDARD EQU 0
CYDEV_PROTECTION_ENABLE EQU 0
CYDEV_STACK_SIZE EQU 0x2000
CYDEV_USB_CLK_OSC_LOCKING_ENABLED_AT_PWR_UP EQU 1
CYDEV_USE_BUNDLED_CMSIS EQU 1
CYDEV_VARIABLE_VDDA EQU 0
CYDEV_VDDA_MV EQU 5000
CYDEV_VDDD_MV EQU 5000
CYDEV_VDDIO0_MV EQU 5000
CYDEV_VDDIO1_MV EQU 5000
CYDEV_VDDIO2_MV EQU 5000
CYDEV_VDDIO3_MV EQU 5000
CYDEV_VIO0_MV EQU 5000
CYDEV_VIO1_MV EQU 5000
CYDEV_VIO2_MV EQU 5000
CYDEV_VIO3_MV EQU 5000
CYIPBLOCK_ARM_CM3_VERSION EQU 0
CYIPBLOCK_P3_ANAIF_VERSION EQU 0
CYIPBLOCK_P3_CAPSENSE_VERSION EQU 0
CYIPBLOCK_P3_COMP_VERSION EQU 0
CYIPBLOCK_P3_DMA_VERSION EQU 0
CYIPBLOCK_P3_DRQ_VERSION EQU 0
CYIPBLOCK_P3_EMIF_VERSION EQU 0
CYIPBLOCK_P3_I2C_VERSION EQU 0
CYIPBLOCK_P3_LCD_VERSION EQU 0
CYIPBLOCK_P3_LPF_VERSION EQU 0
CYIPBLOCK_P3_PM_VERSION EQU 0
CYIPBLOCK_P3_TIMER_VERSION EQU 0
CYIPBLOCK_P3_USB_VERSION EQU 0
CYIPBLOCK_P3_VIDAC_VERSION EQU 0
CYIPBLOCK_P3_VREF_VERSION EQU 0
CYIPBLOCK_S8_GPIO_VERSION EQU 0
CYIPBLOCK_S8_IRQ_VERSION EQU 0
CYIPBLOCK_S8_SAR_VERSION EQU 0
CYIPBLOCK_S8_SIO_VERSION EQU 0
CYIPBLOCK_S8_UDB_VERSION EQU 0
DMA_CHANNELS_USED__MASK0 EQU 0x00000000
CYDEV_BOOTLOADER_ENABLE EQU 1
    ENDIF
    END
