.ifndef INCLUDED_CYFITTERGNU_INC
.set INCLUDED_CYFITTERGNU_INC, 1
.include "cydevicegnu.inc"
.include "cydevicegnu_trm.inc"

/* CS */
.set CS__0__INTTYPE, CYREG_PICU12_INTTYPE2
.set CS__0__MASK, 0x04
.set CS__0__PC, CYREG_PRT12_PC2
.set CS__0__PORT, 12
.set CS__0__SHIFT, 2
.set CS__AG, CYREG_PRT12_AG
.set CS__BIE, CYREG_PRT12_BIE
.set CS__BIT_MASK, CYREG_PRT12_BIT_MASK
.set CS__BYP, CYREG_PRT12_BYP
.set CS__DM0, CYREG_PRT12_DM0
.set CS__DM1, CYREG_PRT12_DM1
.set CS__DM2, CYREG_PRT12_DM2
.set CS__DR, CYREG_PRT12_DR
.set CS__INP_DIS, CYREG_PRT12_INP_DIS
.set CS__INTTYPE_BASE, CYDEV_PICU_INTTYPE_PICU12_BASE
.set CS__MASK, 0x04
.set CS__PORT, 12
.set CS__PRT, CYREG_PRT12_PRT
.set CS__PRTDSI__DBL_SYNC_IN, CYREG_PRT12_DBL_SYNC_IN
.set CS__PRTDSI__OE_SEL0, CYREG_PRT12_OE_SEL0
.set CS__PRTDSI__OE_SEL1, CYREG_PRT12_OE_SEL1
.set CS__PRTDSI__OUT_SEL0, CYREG_PRT12_OUT_SEL0
.set CS__PRTDSI__OUT_SEL1, CYREG_PRT12_OUT_SEL1
.set CS__PRTDSI__SYNC_OUT, CYREG_PRT12_SYNC_OUT
.set CS__PS, CYREG_PRT12_PS
.set CS__SHIFT, 2
.set CS__SIO_CFG, CYREG_PRT12_SIO_CFG
.set CS__SIO_DIFF, CYREG_PRT12_SIO_DIFF
.set CS__SIO_HYST_EN, CYREG_PRT12_SIO_HYST_EN
.set CS__SIO_REG_HIFREQ, CYREG_PRT12_SIO_REG_HIFREQ
.set CS__SLW, CYREG_PRT12_SLW

/* RD */
.set RD__0__INTTYPE, CYREG_PICU12_INTTYPE3
.set RD__0__MASK, 0x08
.set RD__0__PC, CYREG_PRT12_PC3
.set RD__0__PORT, 12
.set RD__0__SHIFT, 3
.set RD__AG, CYREG_PRT12_AG
.set RD__BIE, CYREG_PRT12_BIE
.set RD__BIT_MASK, CYREG_PRT12_BIT_MASK
.set RD__BYP, CYREG_PRT12_BYP
.set RD__DM0, CYREG_PRT12_DM0
.set RD__DM1, CYREG_PRT12_DM1
.set RD__DM2, CYREG_PRT12_DM2
.set RD__DR, CYREG_PRT12_DR
.set RD__INP_DIS, CYREG_PRT12_INP_DIS
.set RD__INTTYPE_BASE, CYDEV_PICU_INTTYPE_PICU12_BASE
.set RD__MASK, 0x08
.set RD__PORT, 12
.set RD__PRT, CYREG_PRT12_PRT
.set RD__PRTDSI__DBL_SYNC_IN, CYREG_PRT12_DBL_SYNC_IN
.set RD__PRTDSI__OE_SEL0, CYREG_PRT12_OE_SEL0
.set RD__PRTDSI__OE_SEL1, CYREG_PRT12_OE_SEL1
.set RD__PRTDSI__OUT_SEL0, CYREG_PRT12_OUT_SEL0
.set RD__PRTDSI__OUT_SEL1, CYREG_PRT12_OUT_SEL1
.set RD__PRTDSI__SYNC_OUT, CYREG_PRT12_SYNC_OUT
.set RD__PS, CYREG_PRT12_PS
.set RD__SHIFT, 3
.set RD__SIO_CFG, CYREG_PRT12_SIO_CFG
.set RD__SIO_DIFF, CYREG_PRT12_SIO_DIFF
.set RD__SIO_HYST_EN, CYREG_PRT12_SIO_HYST_EN
.set RD__SIO_REG_HIFREQ, CYREG_PRT12_SIO_REG_HIFREQ
.set RD__SLW, CYREG_PRT12_SLW

/* RS */
.set RS__0__INTTYPE, CYREG_PICU4_INTTYPE1
.set RS__0__MASK, 0x02
.set RS__0__PC, CYREG_PRT4_PC1
.set RS__0__PORT, 4
.set RS__0__SHIFT, 1
.set RS__AG, CYREG_PRT4_AG
.set RS__AMUX, CYREG_PRT4_AMUX
.set RS__BIE, CYREG_PRT4_BIE
.set RS__BIT_MASK, CYREG_PRT4_BIT_MASK
.set RS__BYP, CYREG_PRT4_BYP
.set RS__CTL, CYREG_PRT4_CTL
.set RS__DM0, CYREG_PRT4_DM0
.set RS__DM1, CYREG_PRT4_DM1
.set RS__DM2, CYREG_PRT4_DM2
.set RS__DR, CYREG_PRT4_DR
.set RS__INP_DIS, CYREG_PRT4_INP_DIS
.set RS__INTTYPE_BASE, CYDEV_PICU_INTTYPE_PICU4_BASE
.set RS__LCD_COM_SEG, CYREG_PRT4_LCD_COM_SEG
.set RS__LCD_EN, CYREG_PRT4_LCD_EN
.set RS__MASK, 0x02
.set RS__PORT, 4
.set RS__PRT, CYREG_PRT4_PRT
.set RS__PRTDSI__CAPS_SEL, CYREG_PRT4_CAPS_SEL
.set RS__PRTDSI__DBL_SYNC_IN, CYREG_PRT4_DBL_SYNC_IN
.set RS__PRTDSI__OE_SEL0, CYREG_PRT4_OE_SEL0
.set RS__PRTDSI__OE_SEL1, CYREG_PRT4_OE_SEL1
.set RS__PRTDSI__OUT_SEL0, CYREG_PRT4_OUT_SEL0
.set RS__PRTDSI__OUT_SEL1, CYREG_PRT4_OUT_SEL1
.set RS__PRTDSI__SYNC_OUT, CYREG_PRT4_SYNC_OUT
.set RS__PS, CYREG_PRT4_PS
.set RS__SHIFT, 1
.set RS__SLW, CYREG_PRT4_SLW

/* WR */
.set WR__0__INTTYPE, CYREG_PICU4_INTTYPE0
.set WR__0__MASK, 0x01
.set WR__0__PC, CYREG_PRT4_PC0
.set WR__0__PORT, 4
.set WR__0__SHIFT, 0
.set WR__AG, CYREG_PRT4_AG
.set WR__AMUX, CYREG_PRT4_AMUX
.set WR__BIE, CYREG_PRT4_BIE
.set WR__BIT_MASK, CYREG_PRT4_BIT_MASK
.set WR__BYP, CYREG_PRT4_BYP
.set WR__CTL, CYREG_PRT4_CTL
.set WR__DM0, CYREG_PRT4_DM0
.set WR__DM1, CYREG_PRT4_DM1
.set WR__DM2, CYREG_PRT4_DM2
.set WR__DR, CYREG_PRT4_DR
.set WR__INP_DIS, CYREG_PRT4_INP_DIS
.set WR__INTTYPE_BASE, CYDEV_PICU_INTTYPE_PICU4_BASE
.set WR__LCD_COM_SEG, CYREG_PRT4_LCD_COM_SEG
.set WR__LCD_EN, CYREG_PRT4_LCD_EN
.set WR__MASK, 0x01
.set WR__PORT, 4
.set WR__PRT, CYREG_PRT4_PRT
.set WR__PRTDSI__CAPS_SEL, CYREG_PRT4_CAPS_SEL
.set WR__PRTDSI__DBL_SYNC_IN, CYREG_PRT4_DBL_SYNC_IN
.set WR__PRTDSI__OE_SEL0, CYREG_PRT4_OE_SEL0
.set WR__PRTDSI__OE_SEL1, CYREG_PRT4_OE_SEL1
.set WR__PRTDSI__OUT_SEL0, CYREG_PRT4_OUT_SEL0
.set WR__PRTDSI__OUT_SEL1, CYREG_PRT4_OUT_SEL1
.set WR__PRTDSI__SYNC_OUT, CYREG_PRT4_SYNC_OUT
.set WR__PS, CYREG_PRT4_PS
.set WR__SHIFT, 0
.set WR__SLW, CYREG_PRT4_SLW

/* RST */
.set RST__0__INTTYPE, CYREG_PICU15_INTTYPE3
.set RST__0__MASK, 0x08
.set RST__0__PC, CYREG_IO_PC_PRT15_PC3
.set RST__0__PORT, 15
.set RST__0__SHIFT, 3
.set RST__AG, CYREG_PRT15_AG
.set RST__AMUX, CYREG_PRT15_AMUX
.set RST__BIE, CYREG_PRT15_BIE
.set RST__BIT_MASK, CYREG_PRT15_BIT_MASK
.set RST__BYP, CYREG_PRT15_BYP
.set RST__CTL, CYREG_PRT15_CTL
.set RST__DM0, CYREG_PRT15_DM0
.set RST__DM1, CYREG_PRT15_DM1
.set RST__DM2, CYREG_PRT15_DM2
.set RST__DR, CYREG_PRT15_DR
.set RST__INP_DIS, CYREG_PRT15_INP_DIS
.set RST__INTTYPE_BASE, CYDEV_PICU_INTTYPE_PICU15_BASE
.set RST__LCD_COM_SEG, CYREG_PRT15_LCD_COM_SEG
.set RST__LCD_EN, CYREG_PRT15_LCD_EN
.set RST__MASK, 0x08
.set RST__PORT, 15
.set RST__PRT, CYREG_PRT15_PRT
.set RST__PRTDSI__CAPS_SEL, CYREG_PRT15_CAPS_SEL
.set RST__PRTDSI__DBL_SYNC_IN, CYREG_PRT15_DBL_SYNC_IN
.set RST__PRTDSI__OE_SEL0, CYREG_PRT15_OE_SEL0
.set RST__PRTDSI__OE_SEL1, CYREG_PRT15_OE_SEL1
.set RST__PRTDSI__OUT_SEL0, CYREG_PRT15_OUT_SEL0
.set RST__PRTDSI__OUT_SEL1, CYREG_PRT15_OUT_SEL1
.set RST__PRTDSI__SYNC_OUT, CYREG_PRT15_SYNC_OUT
.set RST__PS, CYREG_PRT15_PS
.set RST__SHIFT, 3
.set RST__SLW, CYREG_PRT15_SLW

/* DATA */
.set DATA__0__INTTYPE, CYREG_PICU0_INTTYPE0
.set DATA__0__MASK, 0x01
.set DATA__0__PC, CYREG_PRT0_PC0
.set DATA__0__PORT, 0
.set DATA__0__SHIFT, 0
.set DATA__1__INTTYPE, CYREG_PICU0_INTTYPE1
.set DATA__1__MASK, 0x02
.set DATA__1__PC, CYREG_PRT0_PC1
.set DATA__1__PORT, 0
.set DATA__1__SHIFT, 1
.set DATA__2__INTTYPE, CYREG_PICU0_INTTYPE2
.set DATA__2__MASK, 0x04
.set DATA__2__PC, CYREG_PRT0_PC2
.set DATA__2__PORT, 0
.set DATA__2__SHIFT, 2
.set DATA__3__INTTYPE, CYREG_PICU0_INTTYPE3
.set DATA__3__MASK, 0x08
.set DATA__3__PC, CYREG_PRT0_PC3
.set DATA__3__PORT, 0
.set DATA__3__SHIFT, 3
.set DATA__4__INTTYPE, CYREG_PICU0_INTTYPE4
.set DATA__4__MASK, 0x10
.set DATA__4__PC, CYREG_PRT0_PC4
.set DATA__4__PORT, 0
.set DATA__4__SHIFT, 4
.set DATA__5__INTTYPE, CYREG_PICU0_INTTYPE5
.set DATA__5__MASK, 0x20
.set DATA__5__PC, CYREG_PRT0_PC5
.set DATA__5__PORT, 0
.set DATA__5__SHIFT, 5
.set DATA__6__INTTYPE, CYREG_PICU0_INTTYPE6
.set DATA__6__MASK, 0x40
.set DATA__6__PC, CYREG_PRT0_PC6
.set DATA__6__PORT, 0
.set DATA__6__SHIFT, 6
.set DATA__7__INTTYPE, CYREG_PICU0_INTTYPE7
.set DATA__7__MASK, 0x80
.set DATA__7__PC, CYREG_PRT0_PC7
.set DATA__7__PORT, 0
.set DATA__7__SHIFT, 7
.set DATA__AG, CYREG_PRT0_AG
.set DATA__AMUX, CYREG_PRT0_AMUX
.set DATA__BIE, CYREG_PRT0_BIE
.set DATA__BIT_MASK, CYREG_PRT0_BIT_MASK
.set DATA__BYP, CYREG_PRT0_BYP
.set DATA__CTL, CYREG_PRT0_CTL
.set DATA__DM0, CYREG_PRT0_DM0
.set DATA__DM1, CYREG_PRT0_DM1
.set DATA__DM2, CYREG_PRT0_DM2
.set DATA__DR, CYREG_PRT0_DR
.set DATA__INP_DIS, CYREG_PRT0_INP_DIS
.set DATA__INTTYPE_BASE, CYDEV_PICU_INTTYPE_PICU0_BASE
.set DATA__LCD_COM_SEG, CYREG_PRT0_LCD_COM_SEG
.set DATA__LCD_EN, CYREG_PRT0_LCD_EN
.set DATA__MASK, 0xFF
.set DATA__PORT, 0
.set DATA__PRT, CYREG_PRT0_PRT
.set DATA__PRTDSI__CAPS_SEL, CYREG_PRT0_CAPS_SEL
.set DATA__PRTDSI__DBL_SYNC_IN, CYREG_PRT0_DBL_SYNC_IN
.set DATA__PRTDSI__OE_SEL0, CYREG_PRT0_OE_SEL0
.set DATA__PRTDSI__OE_SEL1, CYREG_PRT0_OE_SEL1
.set DATA__PRTDSI__OUT_SEL0, CYREG_PRT0_OUT_SEL0
.set DATA__PRTDSI__OUT_SEL1, CYREG_PRT0_OUT_SEL1
.set DATA__PRTDSI__SYNC_OUT, CYREG_PRT0_SYNC_OUT
.set DATA__PS, CYREG_PRT0_PS
.set DATA__SHIFT, 0
.set DATA__SLW, CYREG_PRT0_SLW

/* Clock_1 */
.set Clock_1__CFG0, CYREG_CLKDIST_DCFG0_CFG0
.set Clock_1__CFG1, CYREG_CLKDIST_DCFG0_CFG1
.set Clock_1__CFG2, CYREG_CLKDIST_DCFG0_CFG2
.set Clock_1__CFG2_SRC_SEL_MASK, 0x07
.set Clock_1__INDEX, 0x00
.set Clock_1__PM_ACT_CFG, CYREG_PM_ACT_CFG2
.set Clock_1__PM_ACT_MSK, 0x01
.set Clock_1__PM_STBY_CFG, CYREG_PM_STBY_CFG2
.set Clock_1__PM_STBY_MSK, 0x01

/* Key_SCL */
.set Key_SCL__0__INTTYPE, CYREG_PICU4_INTTYPE4
.set Key_SCL__0__MASK, 0x10
.set Key_SCL__0__PC, CYREG_PRT4_PC4
.set Key_SCL__0__PORT, 4
.set Key_SCL__0__SHIFT, 4
.set Key_SCL__AG, CYREG_PRT4_AG
.set Key_SCL__AMUX, CYREG_PRT4_AMUX
.set Key_SCL__BIE, CYREG_PRT4_BIE
.set Key_SCL__BIT_MASK, CYREG_PRT4_BIT_MASK
.set Key_SCL__BYP, CYREG_PRT4_BYP
.set Key_SCL__CTL, CYREG_PRT4_CTL
.set Key_SCL__DM0, CYREG_PRT4_DM0
.set Key_SCL__DM1, CYREG_PRT4_DM1
.set Key_SCL__DM2, CYREG_PRT4_DM2
.set Key_SCL__DR, CYREG_PRT4_DR
.set Key_SCL__INP_DIS, CYREG_PRT4_INP_DIS
.set Key_SCL__INTTYPE_BASE, CYDEV_PICU_INTTYPE_PICU4_BASE
.set Key_SCL__LCD_COM_SEG, CYREG_PRT4_LCD_COM_SEG
.set Key_SCL__LCD_EN, CYREG_PRT4_LCD_EN
.set Key_SCL__MASK, 0x10
.set Key_SCL__PORT, 4
.set Key_SCL__PRT, CYREG_PRT4_PRT
.set Key_SCL__PRTDSI__CAPS_SEL, CYREG_PRT4_CAPS_SEL
.set Key_SCL__PRTDSI__DBL_SYNC_IN, CYREG_PRT4_DBL_SYNC_IN
.set Key_SCL__PRTDSI__OE_SEL0, CYREG_PRT4_OE_SEL0
.set Key_SCL__PRTDSI__OE_SEL1, CYREG_PRT4_OE_SEL1
.set Key_SCL__PRTDSI__OUT_SEL0, CYREG_PRT4_OUT_SEL0
.set Key_SCL__PRTDSI__OUT_SEL1, CYREG_PRT4_OUT_SEL1
.set Key_SCL__PRTDSI__SYNC_OUT, CYREG_PRT4_SYNC_OUT
.set Key_SCL__PS, CYREG_PRT4_PS
.set Key_SCL__SHIFT, 4
.set Key_SCL__SLW, CYREG_PRT4_SLW

/* Key_SDA */
.set Key_SDA__0__INTTYPE, CYREG_PICU4_INTTYPE5
.set Key_SDA__0__MASK, 0x20
.set Key_SDA__0__PC, CYREG_PRT4_PC5
.set Key_SDA__0__PORT, 4
.set Key_SDA__0__SHIFT, 5
.set Key_SDA__AG, CYREG_PRT4_AG
.set Key_SDA__AMUX, CYREG_PRT4_AMUX
.set Key_SDA__BIE, CYREG_PRT4_BIE
.set Key_SDA__BIT_MASK, CYREG_PRT4_BIT_MASK
.set Key_SDA__BYP, CYREG_PRT4_BYP
.set Key_SDA__CTL, CYREG_PRT4_CTL
.set Key_SDA__DM0, CYREG_PRT4_DM0
.set Key_SDA__DM1, CYREG_PRT4_DM1
.set Key_SDA__DM2, CYREG_PRT4_DM2
.set Key_SDA__DR, CYREG_PRT4_DR
.set Key_SDA__INP_DIS, CYREG_PRT4_INP_DIS
.set Key_SDA__INTTYPE_BASE, CYDEV_PICU_INTTYPE_PICU4_BASE
.set Key_SDA__LCD_COM_SEG, CYREG_PRT4_LCD_COM_SEG
.set Key_SDA__LCD_EN, CYREG_PRT4_LCD_EN
.set Key_SDA__MASK, 0x20
.set Key_SDA__PORT, 4
.set Key_SDA__PRT, CYREG_PRT4_PRT
.set Key_SDA__PRTDSI__CAPS_SEL, CYREG_PRT4_CAPS_SEL
.set Key_SDA__PRTDSI__DBL_SYNC_IN, CYREG_PRT4_DBL_SYNC_IN
.set Key_SDA__PRTDSI__OE_SEL0, CYREG_PRT4_OE_SEL0
.set Key_SDA__PRTDSI__OE_SEL1, CYREG_PRT4_OE_SEL1
.set Key_SDA__PRTDSI__OUT_SEL0, CYREG_PRT4_OUT_SEL0
.set Key_SDA__PRTDSI__OUT_SEL1, CYREG_PRT4_OUT_SEL1
.set Key_SDA__PRTDSI__SYNC_OUT, CYREG_PRT4_SYNC_OUT
.set Key_SDA__PS, CYREG_PRT4_PS
.set Key_SDA__SHIFT, 5
.set Key_SDA__SLW, CYREG_PRT4_SLW

/* Pin_Run */
.set Pin_Run__0__INTTYPE, CYREG_PICU4_INTTYPE3
.set Pin_Run__0__MASK, 0x08
.set Pin_Run__0__PC, CYREG_PRT4_PC3
.set Pin_Run__0__PORT, 4
.set Pin_Run__0__SHIFT, 3
.set Pin_Run__AG, CYREG_PRT4_AG
.set Pin_Run__AMUX, CYREG_PRT4_AMUX
.set Pin_Run__BIE, CYREG_PRT4_BIE
.set Pin_Run__BIT_MASK, CYREG_PRT4_BIT_MASK
.set Pin_Run__BYP, CYREG_PRT4_BYP
.set Pin_Run__CTL, CYREG_PRT4_CTL
.set Pin_Run__DM0, CYREG_PRT4_DM0
.set Pin_Run__DM1, CYREG_PRT4_DM1
.set Pin_Run__DM2, CYREG_PRT4_DM2
.set Pin_Run__DR, CYREG_PRT4_DR
.set Pin_Run__INP_DIS, CYREG_PRT4_INP_DIS
.set Pin_Run__INTTYPE_BASE, CYDEV_PICU_INTTYPE_PICU4_BASE
.set Pin_Run__LCD_COM_SEG, CYREG_PRT4_LCD_COM_SEG
.set Pin_Run__LCD_EN, CYREG_PRT4_LCD_EN
.set Pin_Run__MASK, 0x08
.set Pin_Run__PORT, 4
.set Pin_Run__PRT, CYREG_PRT4_PRT
.set Pin_Run__PRTDSI__CAPS_SEL, CYREG_PRT4_CAPS_SEL
.set Pin_Run__PRTDSI__DBL_SYNC_IN, CYREG_PRT4_DBL_SYNC_IN
.set Pin_Run__PRTDSI__OE_SEL0, CYREG_PRT4_OE_SEL0
.set Pin_Run__PRTDSI__OE_SEL1, CYREG_PRT4_OE_SEL1
.set Pin_Run__PRTDSI__OUT_SEL0, CYREG_PRT4_OUT_SEL0
.set Pin_Run__PRTDSI__OUT_SEL1, CYREG_PRT4_OUT_SEL1
.set Pin_Run__PRTDSI__SYNC_OUT, CYREG_PRT4_SYNC_OUT
.set Pin_Run__PS, CYREG_PRT4_PS
.set Pin_Run__SHIFT, 3
.set Pin_Run__SLW, CYREG_PRT4_SLW

/* USBFS_1_arb_int */
.set USBFS_1_arb_int__INTC_CLR_EN_REG, CYREG_NVIC_CLRENA0
.set USBFS_1_arb_int__INTC_CLR_PD_REG, CYREG_NVIC_CLRPEND0
.set USBFS_1_arb_int__INTC_MASK, 0x400000
.set USBFS_1_arb_int__INTC_NUMBER, 22
.set USBFS_1_arb_int__INTC_PRIOR_NUM, 7
.set USBFS_1_arb_int__INTC_PRIOR_REG, CYREG_NVIC_PRI_22
.set USBFS_1_arb_int__INTC_SET_EN_REG, CYREG_NVIC_SETENA0
.set USBFS_1_arb_int__INTC_SET_PD_REG, CYREG_NVIC_SETPEND0

/* USBFS_1_bus_reset */
.set USBFS_1_bus_reset__INTC_CLR_EN_REG, CYREG_NVIC_CLRENA0
.set USBFS_1_bus_reset__INTC_CLR_PD_REG, CYREG_NVIC_CLRPEND0
.set USBFS_1_bus_reset__INTC_MASK, 0x800000
.set USBFS_1_bus_reset__INTC_NUMBER, 23
.set USBFS_1_bus_reset__INTC_PRIOR_NUM, 7
.set USBFS_1_bus_reset__INTC_PRIOR_REG, CYREG_NVIC_PRI_23
.set USBFS_1_bus_reset__INTC_SET_EN_REG, CYREG_NVIC_SETENA0
.set USBFS_1_bus_reset__INTC_SET_PD_REG, CYREG_NVIC_SETPEND0

/* USBFS_1_Dm */
.set USBFS_1_Dm__0__INTTYPE, CYREG_PICU15_INTTYPE7
.set USBFS_1_Dm__0__MASK, 0x80
.set USBFS_1_Dm__0__PC, CYREG_IO_PC_PRT15_7_6_PC1
.set USBFS_1_Dm__0__PORT, 15
.set USBFS_1_Dm__0__SHIFT, 7
.set USBFS_1_Dm__AG, CYREG_PRT15_AG
.set USBFS_1_Dm__AMUX, CYREG_PRT15_AMUX
.set USBFS_1_Dm__BIE, CYREG_PRT15_BIE
.set USBFS_1_Dm__BIT_MASK, CYREG_PRT15_BIT_MASK
.set USBFS_1_Dm__BYP, CYREG_PRT15_BYP
.set USBFS_1_Dm__CTL, CYREG_PRT15_CTL
.set USBFS_1_Dm__DM0, CYREG_PRT15_DM0
.set USBFS_1_Dm__DM1, CYREG_PRT15_DM1
.set USBFS_1_Dm__DM2, CYREG_PRT15_DM2
.set USBFS_1_Dm__DR, CYREG_PRT15_DR
.set USBFS_1_Dm__INP_DIS, CYREG_PRT15_INP_DIS
.set USBFS_1_Dm__INTTYPE_BASE, CYDEV_PICU_INTTYPE_PICU15_BASE
.set USBFS_1_Dm__LCD_COM_SEG, CYREG_PRT15_LCD_COM_SEG
.set USBFS_1_Dm__LCD_EN, CYREG_PRT15_LCD_EN
.set USBFS_1_Dm__MASK, 0x80
.set USBFS_1_Dm__PORT, 15
.set USBFS_1_Dm__PRT, CYREG_PRT15_PRT
.set USBFS_1_Dm__PRTDSI__CAPS_SEL, CYREG_PRT15_CAPS_SEL
.set USBFS_1_Dm__PRTDSI__DBL_SYNC_IN, CYREG_PRT15_DBL_SYNC_IN
.set USBFS_1_Dm__PRTDSI__OE_SEL0, CYREG_PRT15_OE_SEL0
.set USBFS_1_Dm__PRTDSI__OE_SEL1, CYREG_PRT15_OE_SEL1
.set USBFS_1_Dm__PRTDSI__OUT_SEL0, CYREG_PRT15_OUT_SEL0
.set USBFS_1_Dm__PRTDSI__OUT_SEL1, CYREG_PRT15_OUT_SEL1
.set USBFS_1_Dm__PRTDSI__SYNC_OUT, CYREG_PRT15_SYNC_OUT
.set USBFS_1_Dm__PS, CYREG_PRT15_PS
.set USBFS_1_Dm__SHIFT, 7
.set USBFS_1_Dm__SLW, CYREG_PRT15_SLW

/* USBFS_1_Dp */
.set USBFS_1_Dp__0__INTTYPE, CYREG_PICU15_INTTYPE6
.set USBFS_1_Dp__0__MASK, 0x40
.set USBFS_1_Dp__0__PC, CYREG_IO_PC_PRT15_7_6_PC0
.set USBFS_1_Dp__0__PORT, 15
.set USBFS_1_Dp__0__SHIFT, 6
.set USBFS_1_Dp__AG, CYREG_PRT15_AG
.set USBFS_1_Dp__AMUX, CYREG_PRT15_AMUX
.set USBFS_1_Dp__BIE, CYREG_PRT15_BIE
.set USBFS_1_Dp__BIT_MASK, CYREG_PRT15_BIT_MASK
.set USBFS_1_Dp__BYP, CYREG_PRT15_BYP
.set USBFS_1_Dp__CTL, CYREG_PRT15_CTL
.set USBFS_1_Dp__DM0, CYREG_PRT15_DM0
.set USBFS_1_Dp__DM1, CYREG_PRT15_DM1
.set USBFS_1_Dp__DM2, CYREG_PRT15_DM2
.set USBFS_1_Dp__DR, CYREG_PRT15_DR
.set USBFS_1_Dp__INP_DIS, CYREG_PRT15_INP_DIS
.set USBFS_1_Dp__INTSTAT, CYREG_PICU15_INTSTAT
.set USBFS_1_Dp__INTTYPE_BASE, CYDEV_PICU_INTTYPE_PICU15_BASE
.set USBFS_1_Dp__LCD_COM_SEG, CYREG_PRT15_LCD_COM_SEG
.set USBFS_1_Dp__LCD_EN, CYREG_PRT15_LCD_EN
.set USBFS_1_Dp__MASK, 0x40
.set USBFS_1_Dp__PORT, 15
.set USBFS_1_Dp__PRT, CYREG_PRT15_PRT
.set USBFS_1_Dp__PRTDSI__CAPS_SEL, CYREG_PRT15_CAPS_SEL
.set USBFS_1_Dp__PRTDSI__DBL_SYNC_IN, CYREG_PRT15_DBL_SYNC_IN
.set USBFS_1_Dp__PRTDSI__OE_SEL0, CYREG_PRT15_OE_SEL0
.set USBFS_1_Dp__PRTDSI__OE_SEL1, CYREG_PRT15_OE_SEL1
.set USBFS_1_Dp__PRTDSI__OUT_SEL0, CYREG_PRT15_OUT_SEL0
.set USBFS_1_Dp__PRTDSI__OUT_SEL1, CYREG_PRT15_OUT_SEL1
.set USBFS_1_Dp__PRTDSI__SYNC_OUT, CYREG_PRT15_SYNC_OUT
.set USBFS_1_Dp__PS, CYREG_PRT15_PS
.set USBFS_1_Dp__SHIFT, 6
.set USBFS_1_Dp__SLW, CYREG_PRT15_SLW
.set USBFS_1_Dp__SNAP, CYREG_PICU_15_SNAP_15

/* USBFS_1_dp_int */
.set USBFS_1_dp_int__INTC_CLR_EN_REG, CYREG_NVIC_CLRENA0
.set USBFS_1_dp_int__INTC_CLR_PD_REG, CYREG_NVIC_CLRPEND0
.set USBFS_1_dp_int__INTC_MASK, 0x1000
.set USBFS_1_dp_int__INTC_NUMBER, 12
.set USBFS_1_dp_int__INTC_PRIOR_NUM, 7
.set USBFS_1_dp_int__INTC_PRIOR_REG, CYREG_NVIC_PRI_12
.set USBFS_1_dp_int__INTC_SET_EN_REG, CYREG_NVIC_SETENA0
.set USBFS_1_dp_int__INTC_SET_PD_REG, CYREG_NVIC_SETPEND0

/* USBFS_1_ep_0 */
.set USBFS_1_ep_0__INTC_CLR_EN_REG, CYREG_NVIC_CLRENA0
.set USBFS_1_ep_0__INTC_CLR_PD_REG, CYREG_NVIC_CLRPEND0
.set USBFS_1_ep_0__INTC_MASK, 0x1000000
.set USBFS_1_ep_0__INTC_NUMBER, 24
.set USBFS_1_ep_0__INTC_PRIOR_NUM, 7
.set USBFS_1_ep_0__INTC_PRIOR_REG, CYREG_NVIC_PRI_24
.set USBFS_1_ep_0__INTC_SET_EN_REG, CYREG_NVIC_SETENA0
.set USBFS_1_ep_0__INTC_SET_PD_REG, CYREG_NVIC_SETPEND0

/* USBFS_1_ep_1 */
.set USBFS_1_ep_1__INTC_CLR_EN_REG, CYREG_NVIC_CLRENA0
.set USBFS_1_ep_1__INTC_CLR_PD_REG, CYREG_NVIC_CLRPEND0
.set USBFS_1_ep_1__INTC_MASK, 0x01
.set USBFS_1_ep_1__INTC_NUMBER, 0
.set USBFS_1_ep_1__INTC_PRIOR_NUM, 7
.set USBFS_1_ep_1__INTC_PRIOR_REG, CYREG_NVIC_PRI_0
.set USBFS_1_ep_1__INTC_SET_EN_REG, CYREG_NVIC_SETENA0
.set USBFS_1_ep_1__INTC_SET_PD_REG, CYREG_NVIC_SETPEND0

/* USBFS_1_ep_2 */
.set USBFS_1_ep_2__INTC_CLR_EN_REG, CYREG_NVIC_CLRENA0
.set USBFS_1_ep_2__INTC_CLR_PD_REG, CYREG_NVIC_CLRPEND0
.set USBFS_1_ep_2__INTC_MASK, 0x02
.set USBFS_1_ep_2__INTC_NUMBER, 1
.set USBFS_1_ep_2__INTC_PRIOR_NUM, 7
.set USBFS_1_ep_2__INTC_PRIOR_REG, CYREG_NVIC_PRI_1
.set USBFS_1_ep_2__INTC_SET_EN_REG, CYREG_NVIC_SETENA0
.set USBFS_1_ep_2__INTC_SET_PD_REG, CYREG_NVIC_SETPEND0

/* USBFS_1_sof_int */
.set USBFS_1_sof_int__INTC_CLR_EN_REG, CYREG_NVIC_CLRENA0
.set USBFS_1_sof_int__INTC_CLR_PD_REG, CYREG_NVIC_CLRPEND0
.set USBFS_1_sof_int__INTC_MASK, 0x200000
.set USBFS_1_sof_int__INTC_NUMBER, 21
.set USBFS_1_sof_int__INTC_PRIOR_NUM, 7
.set USBFS_1_sof_int__INTC_PRIOR_REG, CYREG_NVIC_PRI_21
.set USBFS_1_sof_int__INTC_SET_EN_REG, CYREG_NVIC_SETENA0
.set USBFS_1_sof_int__INTC_SET_PD_REG, CYREG_NVIC_SETPEND0

/* USBFS_1_USB */
.set USBFS_1_USB__ARB_CFG, CYREG_USB_ARB_CFG
.set USBFS_1_USB__ARB_EP1_CFG, CYREG_USB_ARB_EP1_CFG
.set USBFS_1_USB__ARB_EP1_INT_EN, CYREG_USB_ARB_EP1_INT_EN
.set USBFS_1_USB__ARB_EP1_SR, CYREG_USB_ARB_EP1_SR
.set USBFS_1_USB__ARB_EP2_CFG, CYREG_USB_ARB_EP2_CFG
.set USBFS_1_USB__ARB_EP2_INT_EN, CYREG_USB_ARB_EP2_INT_EN
.set USBFS_1_USB__ARB_EP2_SR, CYREG_USB_ARB_EP2_SR
.set USBFS_1_USB__ARB_EP3_CFG, CYREG_USB_ARB_EP3_CFG
.set USBFS_1_USB__ARB_EP3_INT_EN, CYREG_USB_ARB_EP3_INT_EN
.set USBFS_1_USB__ARB_EP3_SR, CYREG_USB_ARB_EP3_SR
.set USBFS_1_USB__ARB_EP4_CFG, CYREG_USB_ARB_EP4_CFG
.set USBFS_1_USB__ARB_EP4_INT_EN, CYREG_USB_ARB_EP4_INT_EN
.set USBFS_1_USB__ARB_EP4_SR, CYREG_USB_ARB_EP4_SR
.set USBFS_1_USB__ARB_EP5_CFG, CYREG_USB_ARB_EP5_CFG
.set USBFS_1_USB__ARB_EP5_INT_EN, CYREG_USB_ARB_EP5_INT_EN
.set USBFS_1_USB__ARB_EP5_SR, CYREG_USB_ARB_EP5_SR
.set USBFS_1_USB__ARB_EP6_CFG, CYREG_USB_ARB_EP6_CFG
.set USBFS_1_USB__ARB_EP6_INT_EN, CYREG_USB_ARB_EP6_INT_EN
.set USBFS_1_USB__ARB_EP6_SR, CYREG_USB_ARB_EP6_SR
.set USBFS_1_USB__ARB_EP7_CFG, CYREG_USB_ARB_EP7_CFG
.set USBFS_1_USB__ARB_EP7_INT_EN, CYREG_USB_ARB_EP7_INT_EN
.set USBFS_1_USB__ARB_EP7_SR, CYREG_USB_ARB_EP7_SR
.set USBFS_1_USB__ARB_EP8_CFG, CYREG_USB_ARB_EP8_CFG
.set USBFS_1_USB__ARB_EP8_INT_EN, CYREG_USB_ARB_EP8_INT_EN
.set USBFS_1_USB__ARB_EP8_SR, CYREG_USB_ARB_EP8_SR
.set USBFS_1_USB__ARB_INT_EN, CYREG_USB_ARB_INT_EN
.set USBFS_1_USB__ARB_INT_SR, CYREG_USB_ARB_INT_SR
.set USBFS_1_USB__ARB_RW1_DR, CYREG_USB_ARB_RW1_DR
.set USBFS_1_USB__ARB_RW1_RA, CYREG_USB_ARB_RW1_RA
.set USBFS_1_USB__ARB_RW1_RA_MSB, CYREG_USB_ARB_RW1_RA_MSB
.set USBFS_1_USB__ARB_RW1_WA, CYREG_USB_ARB_RW1_WA
.set USBFS_1_USB__ARB_RW1_WA_MSB, CYREG_USB_ARB_RW1_WA_MSB
.set USBFS_1_USB__ARB_RW2_DR, CYREG_USB_ARB_RW2_DR
.set USBFS_1_USB__ARB_RW2_RA, CYREG_USB_ARB_RW2_RA
.set USBFS_1_USB__ARB_RW2_RA_MSB, CYREG_USB_ARB_RW2_RA_MSB
.set USBFS_1_USB__ARB_RW2_WA, CYREG_USB_ARB_RW2_WA
.set USBFS_1_USB__ARB_RW2_WA_MSB, CYREG_USB_ARB_RW2_WA_MSB
.set USBFS_1_USB__ARB_RW3_DR, CYREG_USB_ARB_RW3_DR
.set USBFS_1_USB__ARB_RW3_RA, CYREG_USB_ARB_RW3_RA
.set USBFS_1_USB__ARB_RW3_RA_MSB, CYREG_USB_ARB_RW3_RA_MSB
.set USBFS_1_USB__ARB_RW3_WA, CYREG_USB_ARB_RW3_WA
.set USBFS_1_USB__ARB_RW3_WA_MSB, CYREG_USB_ARB_RW3_WA_MSB
.set USBFS_1_USB__ARB_RW4_DR, CYREG_USB_ARB_RW4_DR
.set USBFS_1_USB__ARB_RW4_RA, CYREG_USB_ARB_RW4_RA
.set USBFS_1_USB__ARB_RW4_RA_MSB, CYREG_USB_ARB_RW4_RA_MSB
.set USBFS_1_USB__ARB_RW4_WA, CYREG_USB_ARB_RW4_WA
.set USBFS_1_USB__ARB_RW4_WA_MSB, CYREG_USB_ARB_RW4_WA_MSB
.set USBFS_1_USB__ARB_RW5_DR, CYREG_USB_ARB_RW5_DR
.set USBFS_1_USB__ARB_RW5_RA, CYREG_USB_ARB_RW5_RA
.set USBFS_1_USB__ARB_RW5_RA_MSB, CYREG_USB_ARB_RW5_RA_MSB
.set USBFS_1_USB__ARB_RW5_WA, CYREG_USB_ARB_RW5_WA
.set USBFS_1_USB__ARB_RW5_WA_MSB, CYREG_USB_ARB_RW5_WA_MSB
.set USBFS_1_USB__ARB_RW6_DR, CYREG_USB_ARB_RW6_DR
.set USBFS_1_USB__ARB_RW6_RA, CYREG_USB_ARB_RW6_RA
.set USBFS_1_USB__ARB_RW6_RA_MSB, CYREG_USB_ARB_RW6_RA_MSB
.set USBFS_1_USB__ARB_RW6_WA, CYREG_USB_ARB_RW6_WA
.set USBFS_1_USB__ARB_RW6_WA_MSB, CYREG_USB_ARB_RW6_WA_MSB
.set USBFS_1_USB__ARB_RW7_DR, CYREG_USB_ARB_RW7_DR
.set USBFS_1_USB__ARB_RW7_RA, CYREG_USB_ARB_RW7_RA
.set USBFS_1_USB__ARB_RW7_RA_MSB, CYREG_USB_ARB_RW7_RA_MSB
.set USBFS_1_USB__ARB_RW7_WA, CYREG_USB_ARB_RW7_WA
.set USBFS_1_USB__ARB_RW7_WA_MSB, CYREG_USB_ARB_RW7_WA_MSB
.set USBFS_1_USB__ARB_RW8_DR, CYREG_USB_ARB_RW8_DR
.set USBFS_1_USB__ARB_RW8_RA, CYREG_USB_ARB_RW8_RA
.set USBFS_1_USB__ARB_RW8_RA_MSB, CYREG_USB_ARB_RW8_RA_MSB
.set USBFS_1_USB__ARB_RW8_WA, CYREG_USB_ARB_RW8_WA
.set USBFS_1_USB__ARB_RW8_WA_MSB, CYREG_USB_ARB_RW8_WA_MSB
.set USBFS_1_USB__BUF_SIZE, CYREG_USB_BUF_SIZE
.set USBFS_1_USB__BUS_RST_CNT, CYREG_USB_BUS_RST_CNT
.set USBFS_1_USB__CR0, CYREG_USB_CR0
.set USBFS_1_USB__CR1, CYREG_USB_CR1
.set USBFS_1_USB__CWA, CYREG_USB_CWA
.set USBFS_1_USB__CWA_MSB, CYREG_USB_CWA_MSB
.set USBFS_1_USB__DMA_THRES, CYREG_USB_DMA_THRES
.set USBFS_1_USB__DMA_THRES_MSB, CYREG_USB_DMA_THRES_MSB
.set USBFS_1_USB__DYN_RECONFIG, CYREG_USB_DYN_RECONFIG
.set USBFS_1_USB__EP_ACTIVE, CYREG_USB_EP_ACTIVE
.set USBFS_1_USB__EP_TYPE, CYREG_USB_EP_TYPE
.set USBFS_1_USB__EP0_CNT, CYREG_USB_EP0_CNT
.set USBFS_1_USB__EP0_CR, CYREG_USB_EP0_CR
.set USBFS_1_USB__EP0_DR0, CYREG_USB_EP0_DR0
.set USBFS_1_USB__EP0_DR1, CYREG_USB_EP0_DR1
.set USBFS_1_USB__EP0_DR2, CYREG_USB_EP0_DR2
.set USBFS_1_USB__EP0_DR3, CYREG_USB_EP0_DR3
.set USBFS_1_USB__EP0_DR4, CYREG_USB_EP0_DR4
.set USBFS_1_USB__EP0_DR5, CYREG_USB_EP0_DR5
.set USBFS_1_USB__EP0_DR6, CYREG_USB_EP0_DR6
.set USBFS_1_USB__EP0_DR7, CYREG_USB_EP0_DR7
.set USBFS_1_USB__MEM_DATA, CYREG_USB_MEM_DATA_MBASE
.set USBFS_1_USB__PM_ACT_CFG, CYREG_PM_ACT_CFG5
.set USBFS_1_USB__PM_ACT_MSK, 0x01
.set USBFS_1_USB__PM_STBY_CFG, CYREG_PM_STBY_CFG5
.set USBFS_1_USB__PM_STBY_MSK, 0x01
.set USBFS_1_USB__SIE_EP_INT_EN, CYREG_USB_SIE_EP_INT_EN
.set USBFS_1_USB__SIE_EP_INT_SR, CYREG_USB_SIE_EP_INT_SR
.set USBFS_1_USB__SIE_EP1_CNT0, CYREG_USB_SIE_EP1_CNT0
.set USBFS_1_USB__SIE_EP1_CNT1, CYREG_USB_SIE_EP1_CNT1
.set USBFS_1_USB__SIE_EP1_CR0, CYREG_USB_SIE_EP1_CR0
.set USBFS_1_USB__SIE_EP2_CNT0, CYREG_USB_SIE_EP2_CNT0
.set USBFS_1_USB__SIE_EP2_CNT1, CYREG_USB_SIE_EP2_CNT1
.set USBFS_1_USB__SIE_EP2_CR0, CYREG_USB_SIE_EP2_CR0
.set USBFS_1_USB__SIE_EP3_CNT0, CYREG_USB_SIE_EP3_CNT0
.set USBFS_1_USB__SIE_EP3_CNT1, CYREG_USB_SIE_EP3_CNT1
.set USBFS_1_USB__SIE_EP3_CR0, CYREG_USB_SIE_EP3_CR0
.set USBFS_1_USB__SIE_EP4_CNT0, CYREG_USB_SIE_EP4_CNT0
.set USBFS_1_USB__SIE_EP4_CNT1, CYREG_USB_SIE_EP4_CNT1
.set USBFS_1_USB__SIE_EP4_CR0, CYREG_USB_SIE_EP4_CR0
.set USBFS_1_USB__SIE_EP5_CNT0, CYREG_USB_SIE_EP5_CNT0
.set USBFS_1_USB__SIE_EP5_CNT1, CYREG_USB_SIE_EP5_CNT1
.set USBFS_1_USB__SIE_EP5_CR0, CYREG_USB_SIE_EP5_CR0
.set USBFS_1_USB__SIE_EP6_CNT0, CYREG_USB_SIE_EP6_CNT0
.set USBFS_1_USB__SIE_EP6_CNT1, CYREG_USB_SIE_EP6_CNT1
.set USBFS_1_USB__SIE_EP6_CR0, CYREG_USB_SIE_EP6_CR0
.set USBFS_1_USB__SIE_EP7_CNT0, CYREG_USB_SIE_EP7_CNT0
.set USBFS_1_USB__SIE_EP7_CNT1, CYREG_USB_SIE_EP7_CNT1
.set USBFS_1_USB__SIE_EP7_CR0, CYREG_USB_SIE_EP7_CR0
.set USBFS_1_USB__SIE_EP8_CNT0, CYREG_USB_SIE_EP8_CNT0
.set USBFS_1_USB__SIE_EP8_CNT1, CYREG_USB_SIE_EP8_CNT1
.set USBFS_1_USB__SIE_EP8_CR0, CYREG_USB_SIE_EP8_CR0
.set USBFS_1_USB__SOF0, CYREG_USB_SOF0
.set USBFS_1_USB__SOF1, CYREG_USB_SOF1
.set USBFS_1_USB__USB_CLK_EN, CYREG_USB_USB_CLK_EN
.set USBFS_1_USB__USBIO_CR0, CYREG_USB_USBIO_CR0
.set USBFS_1_USB__USBIO_CR1, CYREG_USB_USBIO_CR1

/* Pin_Stop */
.set Pin_Stop__0__INTTYPE, CYREG_PICU4_INTTYPE2
.set Pin_Stop__0__MASK, 0x04
.set Pin_Stop__0__PC, CYREG_PRT4_PC2
.set Pin_Stop__0__PORT, 4
.set Pin_Stop__0__SHIFT, 2
.set Pin_Stop__AG, CYREG_PRT4_AG
.set Pin_Stop__AMUX, CYREG_PRT4_AMUX
.set Pin_Stop__BIE, CYREG_PRT4_BIE
.set Pin_Stop__BIT_MASK, CYREG_PRT4_BIT_MASK
.set Pin_Stop__BYP, CYREG_PRT4_BYP
.set Pin_Stop__CTL, CYREG_PRT4_CTL
.set Pin_Stop__DM0, CYREG_PRT4_DM0
.set Pin_Stop__DM1, CYREG_PRT4_DM1
.set Pin_Stop__DM2, CYREG_PRT4_DM2
.set Pin_Stop__DR, CYREG_PRT4_DR
.set Pin_Stop__INP_DIS, CYREG_PRT4_INP_DIS
.set Pin_Stop__INTTYPE_BASE, CYDEV_PICU_INTTYPE_PICU4_BASE
.set Pin_Stop__LCD_COM_SEG, CYREG_PRT4_LCD_COM_SEG
.set Pin_Stop__LCD_EN, CYREG_PRT4_LCD_EN
.set Pin_Stop__MASK, 0x04
.set Pin_Stop__PORT, 4
.set Pin_Stop__PRT, CYREG_PRT4_PRT
.set Pin_Stop__PRTDSI__CAPS_SEL, CYREG_PRT4_CAPS_SEL
.set Pin_Stop__PRTDSI__DBL_SYNC_IN, CYREG_PRT4_DBL_SYNC_IN
.set Pin_Stop__PRTDSI__OE_SEL0, CYREG_PRT4_OE_SEL0
.set Pin_Stop__PRTDSI__OE_SEL1, CYREG_PRT4_OE_SEL1
.set Pin_Stop__PRTDSI__OUT_SEL0, CYREG_PRT4_OUT_SEL0
.set Pin_Stop__PRTDSI__OUT_SEL1, CYREG_PRT4_OUT_SEL1
.set Pin_Stop__PRTDSI__SYNC_OUT, CYREG_PRT4_SYNC_OUT
.set Pin_Stop__PS, CYREG_PRT4_PS
.set Pin_Stop__SHIFT, 2
.set Pin_Stop__SLW, CYREG_PRT4_SLW

/* Control_Reg_1 */
.set Control_Reg_1_Sync_ctrl_reg__0__MASK, 0x01
.set Control_Reg_1_Sync_ctrl_reg__0__POS, 0
.set Control_Reg_1_Sync_ctrl_reg__16BIT_CONTROL_AUX_CTL_REG, CYREG_B0_UDB01_02_ACTL
.set Control_Reg_1_Sync_ctrl_reg__16BIT_CONTROL_CONTROL_REG, CYREG_B0_UDB01_02_CTL
.set Control_Reg_1_Sync_ctrl_reg__16BIT_CONTROL_COUNT_REG, CYREG_B0_UDB01_02_CTL
.set Control_Reg_1_Sync_ctrl_reg__16BIT_COUNT_CONTROL_REG, CYREG_B0_UDB01_02_CTL
.set Control_Reg_1_Sync_ctrl_reg__16BIT_COUNT_COUNT_REG, CYREG_B0_UDB01_02_CTL
.set Control_Reg_1_Sync_ctrl_reg__16BIT_MASK_MASK_REG, CYREG_B0_UDB01_02_MSK
.set Control_Reg_1_Sync_ctrl_reg__16BIT_MASK_PERIOD_REG, CYREG_B0_UDB01_02_MSK
.set Control_Reg_1_Sync_ctrl_reg__16BIT_PERIOD_MASK_REG, CYREG_B0_UDB01_02_MSK
.set Control_Reg_1_Sync_ctrl_reg__16BIT_PERIOD_PERIOD_REG, CYREG_B0_UDB01_02_MSK
.set Control_Reg_1_Sync_ctrl_reg__CONTROL_AUX_CTL_REG, CYREG_B0_UDB01_ACTL
.set Control_Reg_1_Sync_ctrl_reg__CONTROL_REG, CYREG_B0_UDB01_CTL
.set Control_Reg_1_Sync_ctrl_reg__CONTROL_ST_REG, CYREG_B0_UDB01_ST_CTL
.set Control_Reg_1_Sync_ctrl_reg__COUNT_REG, CYREG_B0_UDB01_CTL
.set Control_Reg_1_Sync_ctrl_reg__COUNT_ST_REG, CYREG_B0_UDB01_ST_CTL
.set Control_Reg_1_Sync_ctrl_reg__MASK, 0x01
.set Control_Reg_1_Sync_ctrl_reg__MASK_CTL_AUX_CTL_REG, CYREG_B0_UDB01_MSK_ACTL
.set Control_Reg_1_Sync_ctrl_reg__PER_CTL_AUX_CTL_REG, CYREG_B0_UDB01_MSK_ACTL
.set Control_Reg_1_Sync_ctrl_reg__PERIOD_REG, CYREG_B0_UDB01_MSK

/* Miscellaneous */
.set BCLK__BUS_CLK__HZ, 64000000
.set BCLK__BUS_CLK__KHZ, 64000
.set BCLK__BUS_CLK__MHZ, 64
.set CYDEV_BOOTLOADER_APPLICATIONS, 1
.set CYDEV_BOOTLOADER_CHECKSUM_BASIC, 0
.set CYDEV_BOOTLOADER_CHECKSUM_CRC, 1
.set CYDEV_BOOTLOADER_IO_COMP_CUSTOM_IO, 0
.set CyBtldr_Custom_Interface, CYDEV_BOOTLOADER_IO_COMP_CUSTOM_IO
.set CYDEV_BOOTLOADER_IO_COMP_USBFS_1, 1
.set CyBtldr_USBFS_1, CYDEV_BOOTLOADER_IO_COMP_USBFS_1
.set CYDEV_BOOTLOADER_IO_COMP, CYDEV_BOOTLOADER_IO_COMP_USBFS_1
.set CYDEV_CHIP_DIE_LEOPARD, 1
.set CYDEV_CHIP_DIE_PANTHER, 18
.set CYDEV_CHIP_DIE_PSOC4A, 10
.set CYDEV_CHIP_DIE_PSOC5LP, 17
.set CYDEV_CHIP_DIE_TMA4, 2
.set CYDEV_CHIP_DIE_UNKNOWN, 0
.set CYDEV_CHIP_FAMILY_PSOC3, 1
.set CYDEV_CHIP_FAMILY_PSOC4, 2
.set CYDEV_CHIP_FAMILY_PSOC5, 3
.set CYDEV_CHIP_FAMILY_UNKNOWN, 0
.set CYDEV_CHIP_FAMILY_USED, CYDEV_CHIP_FAMILY_PSOC5
.set CYDEV_CHIP_JTAG_ID, 0x2E133069
.set CYDEV_CHIP_MEMBER_3A, 1
.set CYDEV_CHIP_MEMBER_4A, 10
.set CYDEV_CHIP_MEMBER_4C, 15
.set CYDEV_CHIP_MEMBER_4D, 6
.set CYDEV_CHIP_MEMBER_4E, 4
.set CYDEV_CHIP_MEMBER_4F, 11
.set CYDEV_CHIP_MEMBER_4G, 2
.set CYDEV_CHIP_MEMBER_4H, 9
.set CYDEV_CHIP_MEMBER_4I, 14
.set CYDEV_CHIP_MEMBER_4J, 7
.set CYDEV_CHIP_MEMBER_4K, 8
.set CYDEV_CHIP_MEMBER_4L, 13
.set CYDEV_CHIP_MEMBER_4M, 12
.set CYDEV_CHIP_MEMBER_4N, 5
.set CYDEV_CHIP_MEMBER_4U, 3
.set CYDEV_CHIP_MEMBER_5A, 17
.set CYDEV_CHIP_MEMBER_5B, 16
.set CYDEV_CHIP_MEMBER_UNKNOWN, 0
.set CYDEV_CHIP_MEMBER_USED, CYDEV_CHIP_MEMBER_5B
.set CYDEV_CHIP_DIE_EXPECT, CYDEV_CHIP_MEMBER_USED
.set CYDEV_CHIP_DIE_ACTUAL, CYDEV_CHIP_DIE_EXPECT
.set CYDEV_CHIP_REV_LEOPARD_ES1, 0
.set CYDEV_CHIP_REV_LEOPARD_ES2, 1
.set CYDEV_CHIP_REV_LEOPARD_ES3, 3
.set CYDEV_CHIP_REV_LEOPARD_PRODUCTION, 3
.set CYDEV_CHIP_REV_PANTHER_ES0, 0
.set CYDEV_CHIP_REV_PANTHER_ES1, 1
.set CYDEV_CHIP_REV_PANTHER_PRODUCTION, 1
.set CYDEV_CHIP_REV_PSOC4A_ES0, 17
.set CYDEV_CHIP_REV_PSOC4A_PRODUCTION, 17
.set CYDEV_CHIP_REV_PSOC5LP_ES0, 0
.set CYDEV_CHIP_REV_PSOC5LP_PRODUCTION, 0
.set CYDEV_CHIP_REV_TMA4_ES, 17
.set CYDEV_CHIP_REV_TMA4_ES2, 33
.set CYDEV_CHIP_REV_TMA4_PRODUCTION, 17
.set CYDEV_CHIP_REVISION_3A_ES1, 0
.set CYDEV_CHIP_REVISION_3A_ES2, 1
.set CYDEV_CHIP_REVISION_3A_ES3, 3
.set CYDEV_CHIP_REVISION_3A_PRODUCTION, 3
.set CYDEV_CHIP_REVISION_4A_ES0, 17
.set CYDEV_CHIP_REVISION_4A_PRODUCTION, 17
.set CYDEV_CHIP_REVISION_4C_PRODUCTION, 0
.set CYDEV_CHIP_REVISION_4D_PRODUCTION, 0
.set CYDEV_CHIP_REVISION_4E_PRODUCTION, 0
.set CYDEV_CHIP_REVISION_4F_PRODUCTION, 0
.set CYDEV_CHIP_REVISION_4F_PRODUCTION_256DMA, 0
.set CYDEV_CHIP_REVISION_4F_PRODUCTION_256K, 0
.set CYDEV_CHIP_REVISION_4G_ES, 17
.set CYDEV_CHIP_REVISION_4G_ES2, 33
.set CYDEV_CHIP_REVISION_4G_PRODUCTION, 17
.set CYDEV_CHIP_REVISION_4H_PRODUCTION, 0
.set CYDEV_CHIP_REVISION_4I_PRODUCTION, 0
.set CYDEV_CHIP_REVISION_4J_PRODUCTION, 0
.set CYDEV_CHIP_REVISION_4K_PRODUCTION, 0
.set CYDEV_CHIP_REVISION_4L_PRODUCTION, 0
.set CYDEV_CHIP_REVISION_4M_PRODUCTION, 0
.set CYDEV_CHIP_REVISION_4N_PRODUCTION, 0
.set CYDEV_CHIP_REVISION_4U_PRODUCTION, 0
.set CYDEV_CHIP_REVISION_5A_ES0, 0
.set CYDEV_CHIP_REVISION_5A_ES1, 1
.set CYDEV_CHIP_REVISION_5A_PRODUCTION, 1
.set CYDEV_CHIP_REVISION_5B_ES0, 0
.set CYDEV_CHIP_REVISION_5B_PRODUCTION, 0
.set CYDEV_CHIP_REVISION_USED, CYDEV_CHIP_REVISION_5B_PRODUCTION
.set CYDEV_CHIP_REV_EXPECT, CYDEV_CHIP_REVISION_USED
.set CYDEV_CONFIG_FASTBOOT_ENABLED, 1
.set CYDEV_CONFIG_UNUSED_IO_AllowButWarn, 0
.set CYDEV_CONFIG_UNUSED_IO, CYDEV_CONFIG_UNUSED_IO_AllowButWarn
.set CYDEV_CONFIG_UNUSED_IO_AllowWithInfo, 1
.set CYDEV_CONFIG_UNUSED_IO_Disallowed, 2
.set CYDEV_CONFIGURATION_COMPRESSED, 1
.set CYDEV_CONFIGURATION_DMA, 0
.set CYDEV_CONFIGURATION_ECC, 1
.set CYDEV_CONFIGURATION_IMOENABLED, CYDEV_CONFIG_FASTBOOT_ENABLED
.set CYDEV_CONFIGURATION_MODE_COMPRESSED, 0
.set CYDEV_CONFIGURATION_MODE, CYDEV_CONFIGURATION_MODE_COMPRESSED
.set CYDEV_CONFIGURATION_MODE_DMA, 2
.set CYDEV_CONFIGURATION_MODE_UNCOMPRESSED, 1
.set CYDEV_DEBUG_ENABLE_MASK, 0x20
.set CYDEV_DEBUG_ENABLE_REGISTER, CYREG_MLOGIC_DEBUG
.set CYDEV_DEBUGGING_DPS_Disable, 3
.set CYDEV_DEBUGGING_DPS, CYDEV_DEBUGGING_DPS_Disable
.set CYDEV_DEBUGGING_DPS_JTAG_4, 1
.set CYDEV_DEBUGGING_DPS_JTAG_5, 0
.set CYDEV_DEBUGGING_DPS_SWD, 2
.set CYDEV_DEBUGGING_DPS_SWD_SWV, 6
.set CYDEV_DEBUGGING_ENABLE, 1
.set CYDEV_DEBUGGING_XRES, 0
.set CYDEV_DMA_CHANNELS_AVAILABLE, 24
.set CYDEV_ECC_ENABLE, 0
.set CYDEV_HEAP_SIZE, 0x0800
.set CYDEV_INSTRUCT_CACHE_ENABLED, 1
.set CYDEV_INTR_RISING, 0x00000000
.set CYDEV_IS_EXPORTING_CODE, 0
.set CYDEV_IS_IMPORTING_CODE, 0
.set CYDEV_PROJ_TYPE, 1
.set CYDEV_PROJ_TYPE_BOOTLOADER, 1
.set CYDEV_PROJ_TYPE_LAUNCHER, 5
.set CYDEV_PROJ_TYPE_LOADABLE, 2
.set CYDEV_PROJ_TYPE_LOADABLEANDBOOTLOADER, 4
.set CYDEV_PROJ_TYPE_MULTIAPPBOOTLOADER, 3
.set CYDEV_PROJ_TYPE_STANDARD, 0
.set CYDEV_PROTECTION_ENABLE, 0
.set CYDEV_STACK_SIZE, 0x2000
.set CYDEV_USB_CLK_OSC_LOCKING_ENABLED_AT_PWR_UP, 1
.set CYDEV_USE_BUNDLED_CMSIS, 1
.set CYDEV_VARIABLE_VDDA, 0
.set CYDEV_VDDA_MV, 5000
.set CYDEV_VDDD_MV, 5000
.set CYDEV_VDDIO0_MV, 5000
.set CYDEV_VDDIO1_MV, 5000
.set CYDEV_VDDIO2_MV, 5000
.set CYDEV_VDDIO3_MV, 5000
.set CYDEV_VIO0_MV, 5000
.set CYDEV_VIO1_MV, 5000
.set CYDEV_VIO2_MV, 5000
.set CYDEV_VIO3_MV, 5000
.set CYIPBLOCK_ARM_CM3_VERSION, 0
.set CYIPBLOCK_P3_ANAIF_VERSION, 0
.set CYIPBLOCK_P3_CAPSENSE_VERSION, 0
.set CYIPBLOCK_P3_COMP_VERSION, 0
.set CYIPBLOCK_P3_DMA_VERSION, 0
.set CYIPBLOCK_P3_DRQ_VERSION, 0
.set CYIPBLOCK_P3_EMIF_VERSION, 0
.set CYIPBLOCK_P3_I2C_VERSION, 0
.set CYIPBLOCK_P3_LCD_VERSION, 0
.set CYIPBLOCK_P3_LPF_VERSION, 0
.set CYIPBLOCK_P3_PM_VERSION, 0
.set CYIPBLOCK_P3_TIMER_VERSION, 0
.set CYIPBLOCK_P3_USB_VERSION, 0
.set CYIPBLOCK_P3_VIDAC_VERSION, 0
.set CYIPBLOCK_P3_VREF_VERSION, 0
.set CYIPBLOCK_S8_GPIO_VERSION, 0
.set CYIPBLOCK_S8_IRQ_VERSION, 0
.set CYIPBLOCK_S8_SAR_VERSION, 0
.set CYIPBLOCK_S8_SIO_VERSION, 0
.set CYIPBLOCK_S8_UDB_VERSION, 0
.set DMA_CHANNELS_USED__MASK0, 0x00000000
.set CYDEV_BOOTLOADER_ENABLE, 1
.endif
